#include <WiFi.h>
#include <FastLED.h>

int melo = 60;
int spIn = 25;
int gnd = 22;
int vout = 21;

#define NUM_LEDS 1
#define DATA_PIN 27

CRGB leds[NUM_LEDS];

const char* ssid     = "nyago";
const char* password = "88888888";

int port = 80;

const IPAddress ip(192, 168, 101, 4);
const IPAddress subnet(255, 255, 255, 0);

WiFiServer server(port);

void setup(){
  pinMode(spIn, OUTPUT);
  pinMode(vout, OUTPUT);
  pinMode(gnd, OUTPUT);
  digitalWrite(vout, HIGH);
  digitalWrite(gnd, LOW);

  FastLED.addLeds<SK6812, DATA_PIN, RGB>(leds, NUM_LEDS);

  Serial.begin(115200);
  delay(10);

  if (!WiFi.config(ip, ip, subnet)) {
    Serial.println("Failed to configure");
  }

  WiFi.begin(ssid, password);

  while (WiFi.status() != WL_CONNECTED) {
    delay(500);
    Serial.print(".");
  }

  Serial.println("");
  Serial.println("WiFi connected.");
  Serial.print("IP address: ");
  Serial.println(WiFi.localIP());
  Serial.print("port: ");
  Serial.println(port);

  server.begin();

  for (int i = 0; i < 2; i++) {
    for (uint16_t count = 0; count < 30; count++) {
      digitalWrite(spIn, HIGH);
      delayMicroseconds(460);
      digitalWrite(spIn, LOW);
      delayMicroseconds(460);
    }
    leds[0] = 0xff0000;
    FastLED.show();
    delay(50);
    leds[0] = 0x000000;
    FastLED.show();
  }
}

int value = 0;

const char* html = R"(
<!DOCTYPE html>
<html lang="en">
<head>
  <meta charset="UTF-8">
  <meta http-equiv="X-UA-Compatible" content="IE=edge">
  <meta name="viewport" content="width=device-width, initial-scale=1.0">
  <title>白い雲、黒い箱</title>
  <script>
  </script>
  <style>
    /* http://meyerweb.com/eric/tools/css/reset/
      v2.0 | 20110126
      License: none (public domain)
    */

html, body, div, span, applet, object, iframe,
h1, h2, h3, h4, h5, h6, p, blockquote, pre,
a, abbr, acronym, address, big, cite, code,
del, dfn, em, img, ins, kbd, q, s, samp,
small, strike, strong, sub, sup, tt, var,
b, u, i, center,
dl, dt, dd, ol, ul, li,
fieldset, form, label, legend,
table, caption, tbody, tfoot, thead, tr, th, td,
article, aside, canvas, details, embed,
figure, figcaption, footer, header, hgroup,
menu, nav, output, ruby, section, summary,
time, mark, audio, video {
  margin: 0;
  padding: 0;
  border: 0;
  font-size: 100%;
  font: inherit;
  vertical-align: baseline;
}
/* HTML5 display-role reset for older browsers */
article, aside, details, figcaption, figure,
footer, header, hgroup, menu, nav, section {
  display: block;
}
body {
  line-height: 1;
}
ol, ul {
  list-style: none;
}
blockquote, q {
  quotes: none;
}
blockquote:before, blockquote:after,
q:before, q:after {
  content: '';
  content: none;
}
table {
  border-collapse: collapse;
  border-spacing: 0;
}
body{
  font-family: Georgia, 'Times New Roman', Times, serif;
  width: 100%;
  max-width: 500px;
  margin: 0 auto;
  position: relative;
  background-color: #000000;
  color: #ffffff;
}
img{
  width: 100%;
}
header{
  position: sticky;
  top: 0;
  background-color: #00000000;
  z-index: 10;
  height: fit-content;
  max-height: 50vh;
}
header div{
  max-height: 50vh;
}
header p{
  position: relative;
  top: -2em;
}
header div img{
  object-fit: contain;
  max-height: 50vh;
}
header p{
  text-align: right;
  margin: 0 10px;
}

p{
  line-height: 2em;
}
p a {
  color: #c0c0c0;
}
p a:visited {
  color: #a0a0a0;
}
h1{
  margin: 2em 0;
}

main{
  padding: 10px;
}
article{
  margin: 40px 0 0 0;
  display: none;
}
article.active{
  display: block;
}
article.poem p{
  font-family: Arial, Helvetica, sans-serif;
}
article.cloud_drawing div{
  width: 100px;
  margin: 0 auto;
  min-height: 200px;
  position: relative;
}
article.cloud_drawing div svg{
  margin: 100px 0;
}
article.cloud_drawing p{
  text-align: center;
  position: relative;
  top: -16px;
}
article.note > p {
  text-indent: 1rem;
  text-align: justify;
}
input {
  font-size: 16px;
  width: 100%;
  box-sizing: border-box;
  margin: 10px 0;
}
div.in_code_el{
  overflow-x: scroll;
  background-color: #22222f;
  padding: 16px 10px 0px 10px;
  margin: 16px 0;
}
div.in_code_el code{
  white-space: pre;
}
nav{
  display: flex;
  justify-content: space-around;
  width: 80px;
  padding: 0 10px;
  margin: 0 0 40px auto;
  cursor: pointer;
}
nav p{
  width: 100%;
  font-size: 25px;
}
nav p.prev{
  text-align: left;
}
nav p.next{
  text-align: right;
}
  </style>
  </head>
  <body>
    <header>
      <div>
        <img 
          src="data:image/jpeg;base64,/9j/4AAQSkZJRgABAQABLAEsAAD/4QCMRXhpZgAATU0AKgAAAAgABQESAAMAAAABAAEAAAEaAAUAAAABAAAASgEbAAUAAAABAAAAUgEoAAMAAAABAAIAAIdpAAQAAAABAAAAWgAAAAAAAAEsAAAAAQAAASwAAAABAAOgAQADAAAAAQABAACgAgAEAAAAAQAAAfSgAwAEAAAAAQAAAXwAAAAA/+EJIWh0dHA6Ly9ucy5hZG9iZS5jb20veGFwLzEuMC8APD94cGFja2V0IGJlZ2luPSLvu78iIGlkPSJXNU0wTXBDZWhpSHpyZVN6TlRjemtjOWQiPz4gPHg6eG1wbWV0YSB4bWxuczp4PSJhZG9iZTpuczptZXRhLyIgeDp4bXB0az0iWE1QIENvcmUgNi4wLjAiPiA8cmRmOlJERiB4bWxuczpyZGY9Imh0dHA6Ly93d3cudzMub3JnLzE5OTkvMDIvMjItcmRmLXN5bnRheC1ucyMiPiA8cmRmOkRlc2NyaXB0aW9uIHJkZjphYm91dD0iIi8+IDwvcmRmOlJERj4gPC94OnhtcG1ldGE+ICAgICAgICAgICAgICAgICAgICAgICAgICAgICAgICAgICAgICAgICAgICAgICAgICAgICAgICAgICAgICAgICAgICAgICAgICAgICAgICAgICAgICAgICAgICAgICAgICAgICAgICAgICAgICAgICAgICAgICAgICAgICAgICAgICAgICAgICAgICAgICAgICAgICAgICAgICAgICAgICAgICAgICAgICAgICAgICAgICAgICAgICAgICAgICAgICAgICAgICAgICAgICAgICAgICAgICAgICAgICAgICAgICAgICAgICAgICAgICAgICAgICAgICAgICAgICAgICAgICAgICAgICAgICAgICAgICAgICAgICAgICAgICAgICAgICAgICAgICAgICAgICAgICAgICAgICAgICAgICAgICAgICAgICAgICAgICAgICAgICAgICAgICAgICAgICAgICAgICAgICAgICAgICAgICAgICAgICAgICAgICAgICAgICAgICAgICAgICAgICAgICAgICAgICAgICAgICAgICAgICAgICAgICAgICAgICAgICAgICAgICAgICAgICAgICAgICAgICAgICAgICAgICAgICAgICAgICAgICAgICAgICAgICAgICAgICAgICAgICAgICAgICAgICAgICAgICAgICAgICAgICAgICAgICAgICAgICAgICAgICAgICAgICAgICAgICAgICAgICAgICAgICAgICAgICAgICAgICAgICAgICAgICAgICAgICAgICAgICAgICAgICAgICAgICAgICAgICAgICAgICAgICAgICAgICAgICAgICAgICAgICAgICAgICAgICAgICAgICAgICAgICAgICAgICAgICAgICAgICAgICAgICAgICAgICAgICAgICAgICAgICAgICAgICAgICAgICAgICAgICAgICAgICAgICAgICAgICAgICAgICAgICAgICAgICAgICAgICAgICAgICAgICAgICAgICAgICAgICAgICAgICAgICAgICAgICAgICAgICAgICAgICAgICAgICAgICAgICAgICAgICAgICAgICAgICAgICAgICAgICAgICAgICAgICAgICAgICAgICAgICAgICAgICAgICAgICAgICAgICAgICAgICAgICAgICAgICAgICAgICAgICAgICAgICAgICAgICAgICAgICAgICAgICAgICAgICAgICAgICAgICAgICAgICAgICAgICAgICAgICAgICAgICAgICAgICAgICAgICAgICAgICAgICAgICAgICAgICAgICAgICAgICAgICAgICAgICAgICAgICAgICAgICAgICAgICAgICAgICAgICAgICAgICAgICAgICAgICAgICAgICAgICAgICAgICAgICAgICAgICAgICAgICAgICAgICAgICAgICAgICAgICAgICAgICAgICAgICAgICAgICAgICAgICAgICAgICAgICAgICAgICAgICAgICAgICAgICAgICAgICAgICAgICAgICAgICAgICAgICAgICAgICAgICAgICAgICAgICAgICAgICAgICAgICAgICAgICAgICAgICAgICAgICAgICAgICAgICAgICAgICAgICAgICAgICAgICAgICAgICAgICAgICAgICAgICAgICAgICAgICAgICAgICAgICAgICAgICAgICAgICAgICAgICAgICAgICAgICAgICAgICAgICAgICAgICAgICAgICAgICAgICAgICAgICAgICAgICAgICAgICAgICAgICAgICAgICAgICAgICAgICAgICAgICAgICAgICAgICAgICAgICAgICAgICAgICAgICAgICAgICAgICAgICAgICAgICAgICAgICAgICAgICAgICAgICAgICAgICAgICAgICAgICAgICAgICAgICAgICAgICAgICAgICAgICAgICAgICAgICAgICAgICAgICAgICAgICAgICAgICAgICAgICAgICAgICAgICAgICAgICAgICAgICAgICAgICAgICAgICAgICAgICAgICAgICAgICAgICAgICAgICAgICAgICAgICAgICAgICAgICAgICAgICAgICAgICAgICAgICAgICAgICAgICAgICAgICAgICAgICAgICAgICAgICAgICAgICAgICAgICAgICAgICAgICAgICAgICAgICAgICAgICAgICAgICAgICAgICAgICAgICAgICAgICAgICAgICAgICAgICAgICAgICAgICAgICAgICAgICAgICAgICAgICAgICAgICAgICAgICAgICAgICAgICAgICAgICAgICAgICAgICAgICAgICAgICAgICAgICAgICAgICAgICAgICAgICAgICAgICAgICAgICAgICAgICAgICAgICAgICAgICAgICAgICAgICAgICAgICAgICAgICAgICAgICAgICAgICAgICAgICAgICAgICAgICAgICAgICAgICAgICAgICAgICAgICAgICAgICAgICAgICAgICAgICAgICAgICAgICAgICAgICAgICAgICAgICAgICAgICAgICAgICAgICAgICAgICAgICAgICAgICAgICAgICAgICAgICAgICAgICAgICAgICAgICAgICAgICAgICAgICAgICAgICAgICAgICAgICAgICAgICAgPD94cGFja2V0IGVuZD0idyI/PgD/wAARCAF8AfQDASIAAhEBAxEB/8QAHwAAAQUBAQEBAQEAAAAAAAAAAAECAwQFBgcICQoL/8QAtRAAAgEDAwIEAwUFBAQAAAF9AQIDAAQRBRIhMUEGE1FhByJxFDKBkaEII0KxwRVS0fAkM2JyggkKFhcYGRolJicoKSo0NTY3ODk6Q0RFRkdISUpTVFVWV1hZWmNkZWZnaGlqc3R1dnd4eXqDhIWGh4iJipKTlJWWl5iZmqKjpKWmp6ipqrKztLW2t7i5usLDxMXGx8jJytLT1NXW19jZ2uHi4+Tl5ufo6erx8vP09fb3+Pn6/8QAHwEAAwEBAQEBAQEBAQAAAAAAAAECAwQFBgcICQoL/8QAtREAAgECBAQDBAcFBAQAAQJ3AAECAxEEBSExBhJBUQdhcRMiMoEIFEKRobHBCSMzUvAVYnLRChYkNOEl8RcYGRomJygpKjU2Nzg5OkNERUZHSElKU1RVVldYWVpjZGVmZ2hpanN0dXZ3eHl6goOEhYaHiImKkpOUlZaXmJmaoqOkpaanqKmqsrO0tba3uLm6wsPExcbHyMnK0tPU1dbX2Nna4uPk5ebn6Onq8vP09fb3+Pn6/9sAQwABAQEBAQECAQECAwICAgMEAwMDAwQGBAQEBAQGBwYGBgYGBgcHBwcHBwcHCAgICAgICQkJCQkLCwsLCwsLCwsL/9sAQwECAgIDAwMFAwMFCwgGCAsLCwsLCwsLCwsLCwsLCwsLCwsLCwsLCwsLCwsLCwsLCwsLCwsLCwsLCwsLCwsLCwsL/90ABAAg/9oADAMBAAIRAxEAPwD/AD/6KKKACiiigAooooAKKKKACiiigAooooAKKKKACiiigAooooAKKKKACiiigAooooAKKKKACiinKMsAfWgBtFe+6jB8NfCeh6FHrmhXN1d3+mrdyyx3bQ8yO4UhSrDG1egxWRAvwOuCHki1qAbCSBNav83sGC8fmaAPGaK9gj0T4N6mVhtdX1SycKS5ms45hn0AikB/E4p58C/DbbEf+EuWMvnd5+n3CBfxXdn8KAPHKK9dj+F2l3TRmx8V6IyyE482aSFgB3YNHgfTNIvwe1q6wuj6lpN9IzECOC/i3nHfDFcD3OKAPI67u/kkg+HOm25wRPf3cvuNkcKD8OTUsXw48QQeKG8Ma2Esnhj8+4ldw8UMAGTIzRlhjHQDksQo5Ir0jxDqXw+0nwtoelGwlv4Qly63M0jRSEmba37pCAgOzjLOcdaAPneivW5vDvhLxlBNP4HMtrfxAyNYTEyCSNQSxhkwGZkA3GNhkjJUkjbWVpngO1m0s+IdZ1S3stOJKxSMshknYcMIYtoL7eNxyqrnls8UAec0V6ZaeF/Amqq62GuPbOMKn22BY0du5JSV2Rc9ypx36Vy2teFNd0DV/wCxNTg2XBCsoVldXVhlWVlJVlYchlJB9aAOcr6f8Iyw6X+y14pvWUh7/W9OtQxPDeUrS4+oxn8a+cbrSNVsk8y7t5I1/vMpxz719HXdqLL9kq0Loym98TySAt0YQ2rJkfQnH1FAHzBU9ta3F5OttaRtLI5wqoCzE+gA5NS21hd3aSSW8TyJCu+QqpO1AQCTjoASOTxyPWulvdR0PS9PtIvCkl0Lqa1KX8suxFLu2SkQXLKgUAFi258nhV4IBsaXd6P4aRtI1HZcTTHLSBRIlrJggMo5EjDJ3D7uOmWAI4jVdMutKujbXWDwGVlOUdTyGU9wR0/xrOJzzW3DqU95p8ehXToIkkLRu4OY93UA9lY4JHQHkY5yAYdfUX7KpS08X6zrbMqHT9B1OcO/RT5aoCf++6+XiMGvpX9n+CS38N/ELXSyqkHhm4g+boWuZI1A+pCkCgD5rYYP4Cm05xhiPTim0AFFFFABRRRQAUUUUAFFFFABRRRQAUUUUAFFFFAH/9D/AD/6KKKACiiigAooooAKKKKACiiigAooooAKKKKACiiigAooooAKKKKACiiigAooooAKKKKACnKcMD6c02nJjPPoaAPtLwbfW2jfGDwlcXMjwvo/h9Lhi/8AyyaCyuJyfYA4Oaof8L3+IngLQxa6x4il1rU3Fsv2a5V2NvE0RdgXdcM2Sg6t3+tWzbQn4oeMJXkcrpnhW8ijLjkf6FHDtP4yEV84/FS5W48f6r5b71jnMQPT/VgJ/wCy4oA9hm/aRXUWR9e8O6bflFIBntrV+T35tiR/nmrEXxw+Gl4qLqvgjShtUhvLtUUk/wDAHir5UooA+prL4gfs7+YhuvCTxE5LtDcXMYyfQC6f9AK6BNA/Z/8AEmkR+ILbTNQtbUSSJLJb3kkjqw2YGyS1lyDv654IxXxzX2t8Hr+90H4Xf8JdoOqadb3FheGAW95OkIkuJwzp5gkGGiVE38N8zAKcDNAF6fUvgJfeJm8SabreraVeyosEiH7OyeXGiptdJYolZTtBIbgntWV4i0X9nHxZqEOkXfiK40G6061YeZ/ZqzWc/wAzSKEW3uGYPJ5uRs+T5TlV4r07xv8AEPXtIn0qLwlP4V1Cy+wwzEX0sDySzOCJAz70DbWBXhsZBxXivxm1e91/4aafq3iXSdMs9XOpyrJNppVvMg8lAhkKSyjczZA5HCdKAMuz+H3w30XXLPVfCvxD01bmCeOSIXtjf2i5RgeX8mUDpXT/ABB+EGl+K/Et3feHPGvhQ6fExgsYP7U8nZbRnEYxLEgGfvHnqSa+OlZlOVOD7VObu6I2mV8f7xoA+qbH9i/496vYJrXhmwstVsJGHl3VnqlnJEwOeQxmX0PBweK1PEn7NPxzXwTHZaj4aurm90m4KRvbvBcN9llUsUxDI7fJICVHP3zj0rX+Gl/8WtN/Zqml+Fl7q1pJP4nUTvp9zLboqx2XWRkdFUZcZZiBwOa8d+L3xT8W+L9L0rwh4m8Q3XiVtJ852ubqc3KiacqGWJ3yxRVRRvzhmyRxg0Ad7pfwd8ZeEbnTNK1TwNqVxPctAdQnvdPuSkKzkHy40KKoZI+WdtxySFAA59J+Kfgj+x/2Zfh5pOoW76Sb/VvEd9PJfCSHyba3eCOMCNhuOfMyABuJOO+R85+A/jx8RPDnjCx13UPEuspFBcx3EjQ3crvviHyNtaTaxXC8NwQMHI4r2vxh+0xq1pYJqHgzxFqV9d3zbri0u5Lr7NbOFPmGBWnICSthgmPk5GSAoAB87+IfGsFt4cfwP4JjNnpM7JJdM7obi9dOVMzKT8inlIVOxTydz/NXlvkzEkbGyOvFfY/hf9o7x94vuZ7HWnt0jjtZXeZoEn2LGvZJI5NxJIAGceueh9N1/wAX+FNR1C61v/hG/CVrG6MzwRaeYYUaNZA7Rj7KWUMYJH2F22khQxBFAH51NFKv3lI+oqOvv68sfhrqUY/tbw34dKxK+/7NPJbHKeZnpND08p/X7p4q/qfhv4G6lb2U1l4OngEdsEvCNZDoLlCUYxnz5SEYjhWUMrZXJABoA+S/DOl+FfGvh3/hGoIvsXiOF2e1l3nyr1CMmBgxwsqkZhYYD5KN82wn0X4XyHTPgV8Srjapk8jTLUhv+mtxITj3AXP4V6TefBH4ISaHaeIf7Q1bQpriS4HkNDJfIVi24ZZIYPl+YnO4N0BBr2LXvht8OdQ+CfjrT/Amsajq+ow3by63PJawBbV9LhkmieRFeOVYrohoxKUykwKyKHI3AH5cMcsTTacylWKsMEcEU2gAooooAKKKKACiiigAooooAKKKKACiiigAooooA//R/wA/+iiigAooooAKKKKACiiigAooooAKKKKACiiigAooooAKKKKACiiigAooooAKKKKACiiigArQ0m0+36nb2OCfOkSPA6/MwHH51n12fw6h+0ePtFgJKh7+2BIGSB5i5P4DmgD6H1PVrkeJfirrkLmeOLT2sgxGCxnu7aHn32qfyqtZ+CvA/jXT08d+MUj8Prq9zN5Mlxqnlm6l3EyMkf2SUrGrEqXYhQwxk81YjlmPgP4l+IVJkS81SxtxJt+V5GvJpiAfXCBsDsa4C11j4ZeKvCulaZ41lvtL1DRYpLdpraBblbm13tIihTJH5cymRlDHKMuC2COQCL4o/DrQPB+jpd2Ud/ZXsV9LZT2t8YXIKRRyh0eHhlIkGDyCCCDivCq+kPjZr1l4o8MaDrWlwta2c812La3dg7RwWyW1rEGYcM22HJI4yTjivnIxuv3lIoAZX1R4F0vwhqfwUj0/xVqL6et14hPlkKAjtFaAbWkOfKGZPvlHA6kAV8sqMsAe5r6S1y70Dw58OfDuhXegm7twkt/NcfaZlMk13HBydo2KFUBFA7deTyAeSfEK91WbxJLp+qWY077AFtI7RTkQxxcKu7ncepL/AMRJboRXDliRiux8YX82v6mdZ8uOCPyoYlQXCzPtijWMEnO4kheTiuOIIoASiivQPBnhSz1e2udd1tblrCzKIUtI980ssmdqKSCq8KWZmzgDgEkCgD6c8P8Awq+Jmt/AbwlqPw1g+0O+rapfyNBdQpLGy+TAhKtIrDcEbGRzjoRXlPxa+EPxA0bUbPVb/wAP3VlPqFolxcRKisgn3tG5QRkgK5XeB2LEAAYp/wAYNSg8N2fhjw14SMtjBBpNvfOguXkkFxfjzX3EBNpA24ULx1zzx5bZfEfxxYLst9TuApbeQz78t6ndnP40AZs3g7xXbQSXF1pt1EkRRXLwSAAyHCgnbgZPAz1PSuaIxwa+m/hZ8YPibea5d6L/AGvMlpqdpJBeRqsa+bESCASEBBDAFWUhlIypBr521O8a71ae/wA7jJK8nPcsxNAHq3wc1HTtP1DUBrECXMUtn5Co87Q4aeeBMgoQcqMnB4PevoSPVvCGreG/K+xMn2i0CmOO8LMDMgyPnjbn/Sj+len/AAa/aKu9A+G2l6JJpNndCw07yCv2qSHeokuNpKFJVEmY1O8AEk59q6+D4v8Ag/WpYo/Efh9ZFMCTHmyuFODFx+8skJI+Q9f4RQB4Lc2ng+fQJ5yL9FltpnKhoXJ81bs45Vf+e5x/wGuK8d2ng1vCbwz6hcwRy3Knc9qkjAme9f8Agm/M+mOPT7Hn8Z/s4aNq8OneJPCS3MUBto7yK3tbWNyZRabo0lgnhKsvnICcYDIwOQK+Zvjv4v8A2ftS+H7aX4RsZ4dWlayubQeVLCEgkVmIkDXM8Rby3A+XHzZxxQB8o67oNjo2n2OuaHqIvYp5JY8iJoGR4QjEEMeQQ45HHUV+1nxq8R+KbT9i/wCHmk+IbmS4ubTw14khSfcFdbSKz0y2MG5QrPE0s5co5YF1DHlVI/GLXo0tfAegKyLmQ30mR1OXVOfptr9gf224r7Sf2cvBel2sRiVfD2t4YdAbnXLKHA9cpAQcZxkZxkZAPw6uWL3EjnqWJ/WoaVjkk+tJQAUUUUAFFFFABRRRQAUUUUAFFFFABRRRQAUUUUAf/9L/AD/6KKKACiiigAooooAKKKKACiiigAooooAKKKKACiiigAooooAKKKKACiiigAooooAKKKKACvV/ghEkvxT0UvIIvLuBLuIyB5as3PtxXlFevfA9jb+PY9SDqn2O0vZ/nGVO2Bxg/XP50AfQPwTfTbL9nf4l+OdUstP1C4Gp6CsEd9bC4WOR5pSzKG9Y3dDgg4PWvmW68fWt55puNB0rMhz8kDRY9hskXFek2epanZfsu39nbTlIL7xJbLJGD97yLV3BP4kYr5xoA9ssvi3p0ejw6Hf+H7K4t7beIEYs4iEjbn2mXzGG48n5utTP8Sfh7dM4u/CNugZQoMUgGPfhFrw2igD3Vdf+Bs27zNDu4vkwNkxPzevMor2DwZ8dvCXhjXbDXdEvtQ0/+zFdYbcoWgYPF5WHUM5bC87tyndg9QK+KqKAP2l+MH7bXxu+O3wUm8Y+L/EGnW+gzvJoMFnaaXDY26XkcAlSQ7LeW4O2Mhsmcgt/CK/LH4hait9o2lx3eoWmo3qPcNJJagDETeXsViI4+chzg569ecV7L42itNB/ZG8H6eimObV9e1a8bnKyC2RIAfYrnH0Ir5EJJ60AJW5omsa9p04h0O6ntnlIA8mRoyW6D7pHr3rDooA+svjL4I8e+L9Y02Wxjl1BLKyjsTLLIvmBrdmXZl2DMqgDaxyCDwSK8OufhX4/tULvpczc7fkAc59gpJP4VzNn4k1+wVFs724iCcKEldQPpgjFa9r8QvHFnIJINWu/lOQGmZlz9GJH6UAeqfDXwXrfhfVLnWvGNrd6XbJp/nxyS2sn7zzZkijCBtgbc2cEEg7T6Gu71z9h/wDaD03T9I8R6Z4fu77Sdd0y11exulESCW1uwTG+0ykjcFJwecdQM14td/G74nalpNpoWqarJeWdg0jW8NykcyReawdwgdDtBYbiBxnnrmvqPWv22P2u/hHc6d4L8LeJtT8KQaXpWmwCwtbtpLYAW6OrrESYo/NVwzRooCnjgg0AdX4f+H/xj8JeCrXRrzTr1kt7eFFhNuJ/L3OWdV2K5wGlY8579uKv2moeMdC8N6hcaxoLvHpkcNyPMsZYpZ7kwKsQT92u0KVLS7QSQuGwABWQ/wDwVX/bTuFgW+8XGcQxrE2+wsH8zb/E/m2suXI4ZhjPpnJPVWn/AAVj/aCMpXW9F8Kaih73WiQO/wCPleRk++RQB5z458X2kn7zXLDTYJbbyUZVBgG6J2+ZV3grva3LYJJ3EnJr5k8c3/hm38SyWUmkRTeVDbRAwXLgYSCNeOWz0r9FYf8Agq3dXVmsfiT4YeFL+Ubt5hgubNZMng/LdtswCQcBs5zxzUF9/wAFBf2bvFqn/hN/gLo1yzn5iurXAyfXD21wP1NAH5v6bJH4p8T+HdAgsXtrWKaG2CSOX3ma43MSSq9d+OnQV+tH/BQrxjfaV8MtI8HfaWbTpvDXhq4igyHjS4urzVrlnXrtZ41XcQRuCruztXHffDn4tf8ABOy/+H2ofGzTfAqeFta0ASJab2mmt7fVZo5fsLmWDTw+0SKJAyfMhCkr2r4I/aU8Z+NvHPwti8e/F/xhD418QeI9TgEGowTPJ/o2l2zxlGD28IwjzkKAOC5ySc5APz7ooooAKKKKACiiigAooooAKKKKACiiigAooooAKKKKAP/T/wA/+iiigAooooAKKKKACiiigAooooA9X+Gui6B4iivtH1SMTTyCMwJGwjusgnJgLkRyH+9C+C4+4wYVz/i3wNqnhdhdZFzYSuUhuYwdjMOqsD80ci9GjcBl9xyeJDEdO9e9+FPiVb6wk2j+MvJMlzCsLXc6FknCfdS7C/MwHGydP30XXLDigDwOivXfHvw5fRoP7d0RH+yYRp4XYPJbeZ9wll+WSF/+Wc6/K3Q7W4PPX/giXS/Adp4y1CdY5NRuWjtrY/feGNfnm9l34QZ6nJ6UAcHRRRQAUUUUAFFFFABRRRQAUUUUAFFFFACjrXrvwlO1fEs2UHl6DfcP33hE49/m4ryEHHNeweAB9l8C+MNTARsWMEGG+8PPuFGR9MflQB1Ov7NO/Zw0S0JTdf63fXA29cQxLHz+fHsa+dq+gfiFCtv8E/AMDBQzJqlx8vORJcIoz74XH4V8/UAFFFFABW/pHhvVtat5ryxjQw2xjWR3kSNQZCQoy5HJwawK7Lwh4hg0qS40nVYWudP1FBDPEr7HG1gyOjHIDo3IyCCMg8GgD3j4w/2VY/AX4Z+HVvIJtQtoNYuLuGGdJTFJcXYChwrEoxRBwcZxkZHNfMiR6azRK0siAg+YdgO09tvzc/jiu5+JvgIeAdZgsra5N9aXlrFd21zsWMTRS5wwVXfA3KwG4gnGdoBFeb0AXvs9oYQ4nG4vtwVPC/3s8/l1oNnHiVknjby8YwSN+f7oIH64qjRQBpNpc4lMKPE5C78iRcY+pI59utImk6hI0KRRF2nBZAuCSB9KzqXJoAuJaXEcYuponEeWUNt4LAHjPT6+1d78W30hvHl/Folnf2NvE6RrDqeftSbI0UiQMSQdwJAJ4Ugdq84WWRcbWIwcjnvUt3d3N9cyXl5I0ssrFndyWZiepJOST9aAK9FFFABUkMM1xKsECl3Y4CqMkn2FR199/wDBMXwT4T+JH7bvw/8AA/jbTbPV9Ov9RkM9pf263VvNHDazyFZIn+V13KpKkjJAoA4H4aar8N7L4DXuk/EK21MRXuvwFZbCSNEYwW5OyXeGbaC27Maluw568X8bNT1a50nStPureGysraa5Wwt7Ri9slptiMbRO3zP5hdneRvmdmJbBGB3PxnvtA8NeFh4cstJs3iPiTWnjeOOSBZY4ZfLQ7UmKrsHCqOi4HOM14p491xNT8K+GbWOPyVhtbjbGCzBUa4cLguSf4fXtxQB5RRRRQAUUUUAFFFFABRRRQAUUUUAFFFFABRRRQAUUUUAf/9T/AD/6KKKACiiigAooooAKKKKACiiigApQSDkV2OjX3gx7AWHiGynWUMxF1ayjdgjgNFICjAezIfer2peAp/sM2teFrlNXsYBuleFSssK+ssTfOo6/MNy/7VAG34C+Ik2jwpoOrTSJarv+zzxqHltGl+9tVvleJ/8AlpC3yv1GG5r0L4oeFtf8f7fF+jWys1pZI0trZIWtobKABRPb4z/o39/dhoHJWTgg18yhGLhOhPrx1r9F/gjrc/wO8L2Wg6+ZorrxhaxaxLeQuTLomlo2UuVUAqfOYCSaBwyXEKpGRvK5APzndHjcxyAqynBB4IIptfbn7R3wCm0TUL/XtDsorO4sUjuL+0tMvZtbXBIgv7F+d9hcY+UH57WTMMmAFI+JGVlYqwwRwQaAEooooAKKKKACiiigAooooAKKKKACvY/CKGD4TeJ7lkR1mudOgBJ+YEO7nHscc145XsUULR/AySZUA87XFXeDziO2ZsEenzA/UUAbvxpeS18OeBdHCBEj8Pwz4HdrmWRifqQATXgFfQv7Q8YtNf0XRlUKdO0HTYHVTkK3llzz/wACz+NfPVABRRRQAU+Ntsit6EGmVLCoZyD/AHWP5A0AewfGa6R9Q0PTRw1noOlxOvcM0AkIP/fdeNV7d+0LHFD8VdSs4cYtltoMe0VtEn9K8RoAKKKKACiiigAooooAKKKKACv1v/4IvaHBeftn2HiWfI/sLRdb1AEesVsE9PST1H5V+SFfrx/wSRu7rw34t+LHxBlGLTw98NPEF0XBwQ8vkqPbpG3X9eKAPgf4pQ2MPw+8FLFfS3k9zbXV7ceZC0WyW4lBYAsSH6feGAfQVwHjuKOC10K3jJ+TS4SQexkeSQ/+hZ/Gu2+Nmka54bg8KaBrVvNayQaHbS+VOu1lM7yNx7EAEVwfxBknGsW1lOf+PWwsohkYIxAhI/AkigDhKKKKACiiigAooooAKKKKACiiigAooooAKKKKACiiigD/1f8AP/ooooAKKKKACiiigAooooAKKKKACr+m6pqOj3keoaXO9vPCcpJGxVlPTgjkVQpyKXYIvU8cnAoA+zv2e/hjoX7S3j1LTVoYdMk06Br7UJUIigu4osLsVBgLcTSMkaqmFl3NgKw59knu5vGF9PpWqRpYz72exlZyHtDb8tFJIdyBIEyu8qYtPY/JvlLV80+IZYPhd8FtL8KiK4sfEfiGaDXJpkZSp03aTZqGVtyMXBmx1wQSQQBXvHwi+Ivg34kW0Wt+O4J7rV9MZH1OCNwBfW0C/u50T77PCwHmQx4ABaZAZSAAD6R8D6N4w8OfD7U9I+JUUFloGgyySWl/dRu5sHuMrcARMSZNOulUpcWz5adszbxcEIfz5/aF+D2keDNQl8S+DYnt9MNz9kuLJ3Mx0+7K+YIRMf8AXQSR/vbSf/ltCefnRsv/AGg/2mPEvxj1NdK0pW0vw3YPiwsVIB4wBLKUwplYAEhAEU8gbizt6L8AficPGOlj4TeLkhvp3iSzsrec+X9utC+9tPLkgLIGPm6fJx5Nx+7yEk20AfC1Feq/Fr4cT/D3xF5VtMt5pd6puNPu0BQT25YqGKEAxyKytHNGeY5VZT2z5VQAUUUUAFFFFABRRRQAUUUUAFex6rCLL4P6DaGPa2oaneyhxzuWNY4yCB3GePrXjg54r6Cl02O+8O/D3RZYGZrqWdiM8SCa7VBj0yBigD1f4ztrlp4h1uy+JVzoN60VtPFaCD7K17CY0jW3RmiRJDtQjG7PRskkZr4obG446V7F+0Dqkep/GfxPLatI0KajPGnmcNiI+XyASP4PWvG6ACiiigArV0TT31bVrbS4yQ1zKkQI6/vGC/1rKr0H4URJcfE7w7bP0l1OzT85koA+i/G2tXcvj6+fTL7Tbe1OsXo1NLoxq7iOdkAlSXBli8kKEEYIDbgRuwx8F/4QFNeujd6FdWtrDfXEqadbXEpSaZA7BMcMFGRsBkZQW4ya9o1DURf63/akL6a/huaeebVfO8rcZJJpGl8wf65pNuPJ2cfd287q8S0zx1pVlbWH9oaWl5c6VuFrK0rIpUMZI1lQDDhHYngqSPlPAFAHnFxbz2k721yjRyRsVZWG1lIOCCD0IPBFQ1bv7651K9l1C8bfLO7SO2AMs5yTgYHJNVKACiiigAooooAKKKKACv2B/wCCfF9pui/softN69d3EUUq+A47CNWkVXc3s9wmFUnLds4B4PbrX4/gZIHrX1b8PdetPDHgu8+EYi02e68a/wBm3clxfaUl21rJaO0trHBOzCSHztxS5aNGV422nIUkgHn/AMbUSPxRaaXbsWTTtLs4SMY2YjztP0LY981ynxVmWXx5qKI4cRSLECP+maKn/stfWPjrXH1T4rWz6fq+m2FhBcQxX9hEgtlY7UR8W4UiZXhCogy20gjC9T8ffEWe2uvHutXNmpWKS/uWUE5wplbHP0oA4yiiigAooooAKKKKACiiigAooooAKKKKACiiigAooooA/9b/AD/6KKKACiiigAooooAKKKKACiiigAr1T4N+D4vGXj2ysdTtnuNLtybvUijbNlhbYkuWL8BcRgjcTwSO9eV19S+BrTUPh98B9X+JCNPZXHiK+j0C0uY5PKZIAPNvCBkMyuoSIkKVGCCc8UAeT/GP4g/8LT+JWr+O1s4rCPUJ90VvACEiiRQkagEk8Iq55xnOMDiuK0HXdX8Naxb65oU7213ayLJFJGcMrL3Hb2weCODxX1Z8WPhN8CvDXwC8J+OPBfitNS8S6isR1HTxPbyGIyQvJKPJjAng+zyqsP78t527cmAK+V/DV9p2m6/ZX+r24urWGeJ5oW6SRq4LKfZlBH40AfT9/b3nxJ0BPEnwq0S1tNRXaNbtGRJ52nc5a7jMwOy2kP3kUKsJBySuSPKfEttbaj4gtbXwLa/atVtU23j6WjG2klRhhoUQEgDoXXarNhkA6n7kuf2nPhH8IdVvte+HPhaSRdYW5jsrgWcWhRw2cmzEaNFDNLcnJO8vIqFdgKsd1eV3n7d/iwXM40fQNOggmtzBi5lvLwjJzuAa5jjU/SPjsKAPVL/wR4p+MfwWj1Xx/pz6TeXd99l+03do0CprM2wR3IB2sINQBWG7IGxLpUnAwXI/MfVdLvdG1GbS9Rhkgngdo5I5UMciOhKsrKeQykEEdiCK+lp/2nLzxHfwJ4/8LaDrlpDMJAk1o0MoG0oyiaORXO9TjMpkCsFYDKivYf2rfhHp+p+BvC3x++H76hruna5p6tfapNbuii4hl+yiKc5YLeRbUiuidqzSbZYQyM7AA/PeiiigAooooAKKKKACiiigByY3DPTNfc/g74S+KPFPif4fXelRD7Lp1vYy3ELOVkU+cZnZV291IOM9RXwuv3hxn2r9Hvghol9q2meBfEWq/YdIzqF5cJJM5W61AafaxwhoiNx2quAVOFZt7A9qAPhX4j3i6j4+1rUEO4T391ID67pXP9a4qrV5LLNcNNOdzyfOT6lvm/rVWgAooooAK9p/Z6tUuPjDoUknIgufO/78o8n/ALLXi1exfBCSey8Yza1CMjTtM1O6I/652koH6sKAPI5vlYKD/CD+YzUNeu2XwO+J+p/CK8+OlppUj+F7DUYdJmvy8axrdzIJEiClxIzbCrHahVQw3EZryKgAooooAKKKmtoJLq4jtosbpGCjPAyeKAP3s/4I1f8ABCr4s/8ABVafX/HF14htPAvw/wDC0sNtqOu3cDXjm6nRZUtrW3SSLzZvKZZGZ3EcaumRIzbV/oM0j/gza+C9n8Q01nV/2jZbnwvHIXezh8LpHqLR7ThVle6kt9xYjObUgKPu5y1foz/wbDfA+P4Mf8Ef9O8ZyXpvF+KvizVPEdtCqhVtY7PZpahiGcs0q2YlYZGwvtAG2v3oLAEKTyenvigD/NP/AOC2n/BAPxd/wTK0TSfjv8K/Ep8efDHxBe/2bHqDWotL7T9QKNItveRRkxESqjeTNEEBceW0YZlZv5sK/wBl/wDby/Yq8Jf8FHv2OPEP7HWr6td+HNS1O4h1fStThCSRR6ppx821WeJhl4CygSqrKzLnaynBr/HN8c+EtU8DeKr7wrrUDW13YTy200TlWMc0DtFImVJVtsiMoYH5gM8ZxQByVfoB4J+HZf8AZe0b4yazHrtuX8YL4XTU4k06S1hsZLUySRReY4vhc+cx2EfuBFvG4Pwfz/r91/8AhG5NR/4Jq/BTw1pQTztb+J2qaiql0RT9iWdMsWKpgBe7ZI4HuAfDeoa1BffG6I2OsWLeHk1F0uLaUIksjLNtffDks8rlQUkXKrxggKa+GL+7kv7yW9m+/M7O31Ykn+deu+F70X/xifVspg3V3cDPC8CV+/bivGXOWz7D+VADKKKKACiiigAooooAKKKKACiiigAooooAKKKKACiiigD/1/8AP/ooooAKKKKACiiigAooooAKKKKAHxgM3PQc/lX0R+0HY23g+40D4W2d29wdA0yIXiOrr5WoXf765Qb+oDFQCBgj06Dk/gNpEOs/FnQ4bsBre3uVu7hSm8GG0/fyAjB4Kx7ckYGeciuR+IXig+NvHWseMCrp/al7cXYWRtzqJ5GcAnABIBA4AHFAHJtNM6CN3JUdATxxRDt81d3TPpn9O/071FTkYo4cdQc+tAH2F8VJ/h9fWnhvw1Fbf2PZajpNhfRTR3z3whuZENu/mmbny/3YykZXyh0DAV8mavpl1ouqXGkXy7JrWRopF64ZCQf1Fera18avG15oukaPZanJHFpthHYqiQQQ7I4nZlUNHGrNyxJZyzknJJ7eQXd3dX91JfX0rzTTMXeSRizMx6kk8kn1NAFevuD9mf4nXuoeG7v4J6y097p0jXF9Bp6ySFbrzYgl9bLGvy+bPbJ5lu2QRcwR84c18P1seH9b1Dw3rVrr2kzNb3VnKk0MqctHJGwZGGeMqwBHbjmgDqvih4Fufh54wuvD0twl7CNsttdxDEd1bTKHhnTlvlljZW68Ele1ee1+k/7SXhjRviv8EvCXxr8BpZ2wXTbg6hpyy7rm3mguzHdlVyxNqs00cluOPJimZeQox+bJBBwaAEooooAKKKKACiiigCSLlwMbs9vWv0s0xfg3p3jC7vNGmvLbxB4b03VZpwV/dzKINsUZ+UKkcEWIwFxk8+ufzt8LWaaj4ksLCQErNcwxkDqQzgf1r6g0C9mvPHfxS1mWRmWPSdVjViMbg8ixLn0JAoA+RHbe2fYD8hTKklGJWHuajoAKKKKACvbfg28cFr4su3/5Z+Hr4D6ytFH/AOz14lXtHw+sQPhz401QHa32Oytge+J7yMkfiI6APpy5+NXwusf+CeEXwQ0G6aPxVceNZ9SvbaSCRQ1qIE8uZJgrRsMxpGYy6uG52lfmr8+6UkmkoAKKKKACgHHIoooA/q2/4Imf8HF8v7AHwmu/2V/2l/Cs/jb4dreTalpL6ZPDaappVzdMXuRGbh44J4JpCZTG0kbRyO20ujBY/wBlW/4O+v2OLr4g3Hh6f4IeIV8KRQo9rqia3YDVmmzlvMtzILYLg4G26duoKgEZ/wA7SigD/Sn/AGpf+Dqb9jH4S/s9p8Qf2RvDXiPxF4+8RWE/9hr4gtVsNJ0+4VvIle5kDl5ntmO5reEM7jb8yI4lr/N/8Y+KdV8aeJLvxNrczXF3eyyTzSuAGkllYvI5A4Bd2ZyBwC2BxivV/g78RdLsY7n4bfEWRpPCuslftICeZLaTopWK7gGf9bFnay8iWEtGQTsxwPxI+HevfDXxJJoGtiJ/lSWGe2fzbeeCUbopoXwN8UqEPG3cHBwwYAA4a1jM1zHCOrsB+Zr9uvifHeeEf2Pv2S/A5eN4b2LxPr0vncgvLKHTPQYxIw6E9K/E3S5Ut9St7iXlI5Fdvopyf0r9z/2p/E8/hn4S/s76VpjRg6f8ILm9mjkRW3JeopYfvAcE7cqVAORwetAH4v8AgO2eTUr67DDNvpt9Jk+rQMv5/PmuCIwSPSu98GXK29jr9yyhtulunPbzJYowR/31XBscsT70ANooooAKKKKACiiigAooooAKKKKACiiigAooooAKKKKAP//Q/wA/+iiigAooooAKKKKACiiigAooooA+mvgjqWneFPh54/8AGUwE12NJj0q1jePdGG1SZY5XLDkMsMbbMEHJyOlfM7EFsjpX0rHY6t4f/ZoinjR7eHxLrUqyyxvxMmnwgxxSLnnEpZk4459a6f8Aaj+C/wAHvhRB4ef4VeLY/E/2y2kF00b2rjdD5ey4X7M7mOO43vshm/fp5R35BBoA+QaKKKAPQ9O0H/hJ9F0/TNI8r7cZ7gFCQrsoTfuPcgBSBxjPFcJHayS/cKD/AHnVf5kV+h37DXxtvdF8SaP8IrT7TYvPrLatFfW80ap5kNqU8qeF4JBNFIiMpVmx85IAYBq0db/b/wDiH4Ju7jw54D8KeG/DX2aZ4itpYxkr5RKFQ0aQ8ZHB64+tAHwn4f8Ahn488VRtL4d0i9vlXPzW1tLOpwccNEjg8984r0fSv2WPj/qp+XwrqFvwT/pUQtTge07Rn/GvuHw/+158ZPFHxI8O3V61pd+Hdcv7SKaaaCaZfMkxG8Uy7yFIkPK8bhgjIr4g8a/H343S61eabqHiS+DQymFzCfsm4wsV+7GsbKMjhTgjoaAPsj4XfCX4m/B74ZXsnxB0efUYpNSh2aRaIt5N9llhMd9JKYHZUhktGZAGJJniiIAIr88vif4Nm8A+OdR8Lyyi4S1mIhnBBWeBwHhmBBIIliZJAf8AarY074x/EhfGFh4svNZu7q8srpLqJru5mmXzUbcC29ySCeG55Umvqf8AbC8B6SfB/gv4seBoJp/D2saXCbe9KgRIJZLgx2RK5XzbExy2zAMSUSNjgnFAHwDRRRQAUUUUAFFFFAHf/Cu3a6+JGhRBio+327FlGSAjhifwxmvevASwaxoXxDub3VbTTTrUkVnbTXrNFBNJJcmWQCQIygrGCxB7EeteRfAp1j+KekzNL5IiaWXeRkDy4nb8uK73wBcaHo3wN13WfENjHqyRatYrawTTTwrFI8b+Y6+TImSyfKc56CgDwTxDoF/4evVtr4xv5qCWN4nEiOjE4YEdjjvg1g10nifxJL4mvYrlreK1SCCK3jii3FVSJdo5csxPqSa5ugAooooAK98+H1je3/wr8Q6dAUi+33+m26yytsjRYlubiRmPZVVNx6njgE8V4HX1J4Bt75Pg8txpwtdx1ySSY3ufs4t4bErJ5mPmwRNj5fmyRjnFAHiGv+Dv7K0uLX9LvYdRsJZWg82JXQrIqhtrJIqsMg5U8hgDzkEDiyCDg8V9I21hZ3l3pGjWVnZzaXdC6uYIYriTbeXsUZURyPLsdCDtATC5B4JL5rjPHOkRweFLDVtV01NJ1K4nmVYo42iE1uoX5zGxOwq5KA8Bx2O0mgDyCiiigAooooAKKKKAFBIORX1D8ONW0f4ueFrb4I+KxHbX1p5p8PX7SCKOKaZi72k5JAEFw/MbHPk3BH/LORwPl2pYZpLeQSxHBH4jB6g+oPQjvQBtzaPfaNrdzo+rQS21xaieOWGZDHJHJGrBldGwVZWBDA9CCK/br/go5pmh+H/iba6HdwymbQPhBoun26xsqpG0jSElw4LHhhjBU/hX5vyOv7RPhFLxbhX8b6JbOLgSDM+rWMSYEoIGXubWMASjaXngG/l4mB+xv20/GZ+PPxe+I/i6PUfDUdlplhomjCfRNWbVLUQ2scbtNbym3t5J4zl1bEQIcFOfvEA/Mnw5CieCvEd0yAjFpED3G6bd+uyvNa9p1nwzbaL8NbrWdBvRqFlfahb2/mCNoXSSGOWRkdGz1DKykMQeehGK8WoAKKKKACiiigAooooAKKKKACiiigAooooAKKKKACiiigD/0f8AP/ooooAKKKKACiiigAooooAKfGu91T1IFMqSIZfrjAJ/EDNAHuvxV02TQvAXgfSXuo5zJpkt8yKXEkZvJi4DKyAAFQCpVmB5PHfwuSaWX/WMTyT+J6n6n1r3v9os6JaeMbHw9oN9cX9vpOk6fZiS4QRkMkIZgq9QoL8bsHOeMYz8/wBABRRRQB7t+zPr7eHfjr4WvgcA6lBETx0nJh56cfvOfasX49aPcaD8ZvFGl3ChfL1S6KheBteQuuPbDDFcZ4J1pPDvi7TNekOFsruC4JxuwIpFc8d+lfRf7bOmTWH7RGvTmNFivDb3cbIchllgjBOf95G6cZoA+Z9E8TeIfDVwLvw/fXFjKHjkD28rRMHiO5DlSOVPKnselUtU1TU9c1O41nWbiW7vLyV55553MkssshLM7s2SzMSSSTknk1QooAK/QD4MTzfFL4IXPw2wWktvO02JM7EVrsteWDknI+W9hlgwByLkDrjP5/19I/sxa3fWvj5/DNgyLca3byWtoZHKqt/EVubJiB1xdQxjH+0fXFAHznMgSQhQQDyAeTg8j9Kir2j4+6Rp+nfE7UL/AENHXTdV8vVLLemz/R9QRblAOOQvmFP+AkdRXi9ABRRRQAUUUUAeufBt/sfiG+1pWCtYaVfzqGGQxELLj8d3510jDH7MoDEZm8S5xjn9zaEf+zVzvwrd4LDxVdAoAuh3KfMOpleNcD37iuo8YXD2f7P3hKxwCLzUNUuSV7eWY4xn8zj2oA+eaKKKACiiigAr6FTUpfCHwn8OyzQpd2uo3mrNc28pIWSPFtCORgqQVyrDkEdxkH56HPFe0/EC+X/hWngrTuj/AGW+uCD6TXbgH8fLoA4PxF4lt9WtbTS9MtFsrOzDFUDGRnkkC73dyBlm2qOAAAAAO9czPc3F1IZrl2kc4yzHJOBgcn0FQUUAFFFFABRRRQAUUUUAFFFFAHsHwS1zWND8bRS+Gbia01iUBNNnt4mmljvC6eXsWNXfc/MalUY5fG0gkV9yeM4o9a8AX/jrR47Wx1G3uYbXxJaSI7RabITIDCYXRZTbzt5ixRFd0Exa33LsTHiP/BPL4d2PxQ/bG+HXhDUZLqGK51+0LS2U8lrcxiEPNvimiZJIpEMYZXRlZSMg17H8UPit4j+EPjjxoLW4m1jRZ/HviC2ltNUne7ivbKR5Emjncne7ScO0mdxf94AWHIB8leP54bP4V6RYaa1u1hc3081u1oJEVzFGqSGQSln81SwHJxtxt4NfPdfVv7Qek6baeFvDWp+DC0nhe/N9Npkj5Eoy8QnhuAxJN1C42zEfI4KSJhGwvylQAUUUUAFFFFABRRRQAUUUUAFFFFABRRRQAUUUUAFFFFAH/9L/AD/6KKKACiiigAooooAKKKKACtLSYzNfx26uEMp8rcRnAk+U+nY1m1u+GbBNT8QWWnStsWeeKMk9g7qM/rQB7f8AtaeILXxN+0T4s1WwYPbtfFInUkh0iRYw+SB98KGxjjOBnrXznX6AeDfBfwU+Jn7Tfi/R/jzqMXhywiedbcxyR6Rbu8csURPmPDMI2WDzJ0TysTuoTcu45+IvFtnoGn+Jb6y8L3bX2nxXEqW9w8flNLCrsI3KH7pZArFf4ScdqAOcooooA1dE03U9Y1OLS9GtpLy6uCYooYUMkju4IAVVBJJ7ACvsb9uOw1RPHfh/WtRtTbNqGg2bSKeqzRF1dWA4VlyAV6jvzXyX4L8V6l4G8Wad4v0fb9p0y5iuYg4JQtEwYBgCMqcYYZGQSK91+MnjeHx78M/CesQ6fp+miGbVrcwabbi3hQmaOYfKGbHEnHPAGB0oA+Y6KKKACvXfgXrPhXw98TNP1zxjIsNraCWeN5GmSNLqKNntmcwJJLsE6x7tgzj2zXkVOU7WBNAH2P8AtN2enXPh3w9rct9HqGrRvf2d49mk0dlGona5t44hOiudsdyQCCwVVC5J5r42r6o1OI+K/gdc3xkKHT1069PmuAXcM9hJtBOWwqRE46A844r5XoAKKKKACiiigD2HwQjf8K08YTIUBMVhD833vnuM8f8AfPPtXRfE9f7P+Enw/wBJcqWNle3Py+lxc5GffC4/Cub0PGnfBzW75lV/tmpWNuP7ymJZZfyPQ1u/HRDBa+DLPAUReGbE4U5GZWlcn6nIzQB4HRRRQAUUUUASRDMqj1Ir7l+Hnwm0z4w/Hj4QfCXVTItjrFrpFrdmE7ZRBcTSzS7DhsOYy207TgkHBxXwzHu3gr1HP5V9XXHxa8cfAP47eHPHXg2ZIdU8J2ukNbNJEsyeZDaRk7o3G1lPmOrKeqk8g4IAON/an8M+CvBf7RXjTwh8PI5IdG0vWLu1tI5pTPIkcTldrSHJdlIILHkkV4BXXePfGOpfELxpqvjjWVjW71e8uL2cQoI0825kaV9qjOBuY4GTgYGTiuRoAKKKKACiiigAooooAKKKKAP09/4I76bc6h/wUG8ASom6Cxmvr6ZuMKtvY3GCc8feZR+NfMvx38VWPi7w3pviLTreSE6zrGu6jLK0rSLP51wDGwVgNhUMVIH3upwa+5f+CLiW1p+03q3imU/NonhDxFfdcY2QwoOcE/xnpzX53fFS1tNJ8HeCNIt7lJy+lteOIi21Dcyn5TuVTu+T5sAjPQmgDs/AXjfR9C0bSvht8QYWn8Ma9aebeoq75oJ/OnEN3bAkATRA4K9Jo2aJs5XHi/xJ+HXiD4beIpNF1uOMoypNb3Fu/m21zBKN0c0En8cUi8oSAeCpAZWAX4gSRg6PbRsT5OlWgIPYupc/+hZ/GvVvhrq/h/4meFoPgl4yuGtLlJnfQdQkf9zbXE5G61mJzttrlwPmxiCfEn3XkoA+ZqK1Na0i/wBB1a50XVIZLe5tJXhmimQxyRyRkqyOh5VlIIZT0IrLoAKKKKACiiigAooooAKKKKACiiigAooooAKKKKAP/9P/AD/6KKKACiiigAooooAKKKKACuj8ITtbeJ9PnXqlzC3TPSRT0HWucxV7Tb2402+iv7R2jlhdZEZeGDIQwI9wRmgD1z4/nxLZfG7xO2vzT/bm1CZnaSTe+HOVG4M3G0gAZ4GAemK8Vr2/9o+zs7H42+I4rCaC4hku/OWW33eW4mVZMjcAcndlsjrmvEKACiiigAr3v7Q9x+zaYCH8ux8SBhx8ga7s8dcdT5HTPQV4JXvngGAX/wAGPG9qRlbc6VdtlgACtw8OcE88TY4HA9qAPA6KKnjt5JfulRn+8wX+ZFAEFFdLoPg/xN4ovPsHh2xnvpR1W1iecj8IlY163F+yv+0TNpt5rP8AwhWtpaWNs95LPLYzQRiFFLswMqpuAUEnaDxQB2nwR0y/8a+F5/BlrcgTX0Wo2ESTELEGlhS6Qu54VVa3cljwuc+teSXfwd8WxaXqmu27Wd3a6XeR2Us1rfW06NLKV2+Xtl3SKdw+dEZPUjBx3H7P99BpWrNJfSeQFurKQM/A2ys9szc9ts/Ptz2Fee+CPCljq/iy60PWpR5Fnb3kjshxk28bFcNjgEgfWgC7rvwK+K/h/UNY02+0O58zw/Al1qOwLILaGQZV3aNnUKRnnJ6VzjfDTx/HNb282jX6Pd232yBWtZgZLfGfMQbMsmP4xleetcbPM8zl3xzjhQFH5AAV1Gm+PvGuj3MF5perXlvLbQm3ieK4kRkiPVFKsCqnj5QQOOlAHMfZZwqOy4D8qTwCM4zk8YyMZqJo2Xr+hzXdaT8T/H2i2mnafp+rXUdtpNwbuzh8wtHBMc5dFbKqTuOcDBycgmr2pfFvxtq1hqum39xFNFrN0t5deZbQM7zKQQwfy9yfdGQhVWHBBBNAG15Ug+BiYgDGXW5DvH3sRWwzkenzZr0P4y6APEPxesvBKn7ItlpthbMVXcEEVqJW2jKg8HgZFdpo3jLS/GXhWyg1Cx8KW39oC4tr8PbwW0lrE5SMTW0a7EjuNilt56kKTwK9c0nQpvGHxx1a2+K3hSwsZLWwumiaznNpKxxHbw7mhnkBPl9gueScEUAfCEnw11W9ktJ/C8i6lZ3ocpOv7pY2iXfIs2/AiKL8xLNt2/MCRWXq/gi+0+OOawuIdTRxKxazEkgQQldxJKLx8w+YZHvX6bp8EvhdY6HqHhW10nW7O01YQmeWylkuNnkEkBBJAc784cHsoxXkfxL+F/hP4Z/CG88Y+A9R1y0u4J4tPjXUFFqWNy4nk8tlRHd1WIFx90Ic9RigD88djZxXTW/g3xLd6E/iW1tHksoywaRMMFC9SQDkKP72NvvXqWreNNAg0ax8V6GID4o1BZRfSCIbYDE2FkRGUoJJ1+Z2A42naAWNfXHjH9mv4kSa9pHi3Qtas7bUSkV0I50lQwtcANtmkjSSJsDCPtJVskdDQB+dGj6HrWsSumkWc12yDDLDG0hG7gZCg4yemete1/tGaFrw+IuseIXsp000XpsEuWjYRGa2iRGj3EY3LtOV6jB9DX2Jo/7PfjLTvi1oE/h69sLTwfp+u284jiuhHIwhkWSSZ4yAWIKnG4/KoUDAFeVfErU/E3i3x9qNiEg1Lw3ceItVutSkmcNHFLJdTLI7lnHkkQBXRlAJLZyxJoA+CqK9Ej+HWtatG2o+H0EtrK8osxJIiT3KRE5McZId8Ac4HXIGTxXnmMHFACUVKIZW+6pb6c/ypjI6cOCPrQA2iiigAooooAKKKKAP11/4Jg2c3h/wb8f/AIpWTFbnRvhbq8cXJ277tsDIHPWEdxx3r88/jLZ3OnXPh3SrxJoprTQ7NHjnRkZGO9yNrAEDnIyO9foj+wnqsegfsMftT+JZyVjj8NaNpZYZwG1C7nRQew3FgBk8k4GTxX56/HnUtQ1L4jvaz3E929taWVsrTu0kpAgX5SXJY4LEDJNAHHfEqFbXxS1kjFlt7e1hG7qBHBGMfgc1wsM0lvKJojhh+I9wR3B6EdxXa/Ey7N54+1eQtvCXLxg9MiM7B+grhaAPrRzN+0h4PVvMjm8caJAxk3cT6tYQIPmyM77u1jU7uN1xAAeZIju+T5YpIZDFIMMPx/IjqPQ1q+Hte1Lwxrdp4h0eV4LuxmjuIJYzteOWJgyOp5wysAQfX1HFfZ/wY+H3w/8A2wP2sPht8M9Fhfw7efEbxJo+gagkaK9rb3+r30dq81upJxEVkM6xNxHICnzRlRQB8Uy6LrEFkupTWkyW742ysjBDnphiMHNfS3xN/ZA+M3wo/Z3+H37TfizT4ofC3xJudbtNGuFuo5JJZdAlWG7Dwr80YR2wpYneORiv3w/bi/aE/wCCPfhHXvjL+wkn7O0Pg23+Hya1o3gnx5pF1Nd+KbnxPo80lmsurGZ0iuLK9mSYujyP5cYHyBiuzzD9rTwvqPjz/gkP+wv4H0iKM32veMfibptskjkRCe81eCGMO+N2wO67iBnbnHNAH8440fVmsP7VW1mNqP8Altsby+uPvYx1461VjtbmWGS5ijZo4sb2AJVd3Aye2e2a/t41D4R/8EtfCn7ftl/wQo1P4DaddaZPfW3gmf4rf2jcDxqfEU+nx3A1GNhGIUgW5kWH7Lu8rYM7PL/dH8cPg9+xf8KvDP7Ef7bt78SNGs9Z8YfCPXvAmjaPquGV7R5/EF5pmotCAwCrdLb8qQdqkAdM0AfgtJa3MUMdxLGyxy52MQQrbeDg98Hrivqb9kb9jb44/to/GTTfgf8ABTSkvdb1Wz1C+to7m4Syjkh0y3a5nYSygr8sakgYO48Dmv1D8c/sX/Czxr+wr+wxd/D3RrPSPGvxjvPGOlaxq+1ne7uI/E9rpdhJMpbawto58BQAGUEHrmv6K/2NfiL/AME5fgB/wWEu/wDgm58Ffgbp+gat8OLbxVomgfEGPULqTxBqms2Oi3DakdVyPLmtrmN7jyo2ZlikiRlVfkCgH+ffe2c1jMIZxgsiSD/dkUOp49QQaqV0fin/AJCMX/XpZ/8ApPHXOUAFFFFABRRRQAUUUUAf/9T/AD/6KKKACiiigAooooAKKKKAPVPCvhzStX8E37315BZXE19aw28k4wmQkrMrSdYw2R82CuQN2ByOI1fQdW8NanLpetwPbTRhgVcdsEAjqCp7MCQeoJr0Lw9pU/iDwbp/hy0kihkvdVnIklJCr5UCZyQCcfN6V6jpfhrw3p+mDw1438RWF7YRuQsIKie3LfeMEhfKc8lSpjYjlc80Acn+03baanxTlv8AS5GmjvrKxujJtVY2aW3Qkx7SRs44J5yD7Z0/Af7I3x6+I/hSx8a+GNBkfTNRMgtrmee2tYpfJkaJ9rXE0edrqVPHUYr6g8Y/8Mq3Xh7w1qd/d6bfPFpNtp8konvzcyS2KLG7TWluirDuzlG89lkGSCeTXhPxY+MXgK+sPBfhbwnbwXNp4SuLxjLHZSWwkhup4rjYPtNzdSMwdZTuYqAJMAdTQBS0z9kvXX0m61TxJ4q8KaULNo0nSfXIHeJpM7Qy263BzweAe1d34K/ZI+H/AIzvoPB+kfEXTdR8R6hZT3FjZ6dpt/cxzSQxTSiMXDLCgJ8lhnBwR0ODXzhefEbTNGU6L4KsgNMk3G6S9Cu14W6eYEwqqn8Cocq3zbt3TqPhp8S30/4ueFdZ0G2WwTT5Y7QKXebMdxIyyZJw33ZnAA6e9AGJpX7Onxp1aI3EXhu/giCh991F9lTacc7pzGMc4z0r0/4XfCC/06TxFofirVtC02TUtHuLSJbjVbVn+0eZE8aeXBJLJuZk4G3n8Rn7H+K+qW3w08bS+E/Bvh/w7biKOJoL5tEtbi9LTB03GWYz/MsjJydx4w2Sa4V/2lvjTeyR2Vp4v1S3tJ2RRFZJbWaBZmgAGbaCJgALpSMHt7igDw7Rf2LvGWqXpWW4uJYm5VtO0bVb9ef+mgtIojn1D4HcjBr6I8Y+KfEv7Knhf4eeAPCN1HoV8W1CHWJ5dJsIbx990rxSyNOlxKAIbjavmMPlQcbRmvFk+InjbxO9rNq2v6teJO1uzrcalc3A+drGRhiSVh0mk/h5A9DXyd8S9MudN1q2aaIxC4sLOUDy/LGRCqEjIGQWRsHHP50AfVGp/tR/FGOyfwv4u8d6pcyX8qtJNpl2UjsvJB8vaLcxJLvLN5qq2Au3B3gY5XwZ8fLbwX8YfDvjzxJqU/ieHTbG5t7h50luyxuIrqAjZcyxlxtmUld6jHAPFfHhJPWkoA++rH9pH4W+CZ4tV8C6fc2N7FtUvY6dpNqWVSrDLSxXrg7lB+9jPJzivJPid8WNJh8beKn0Lw3ZWN3qs99DNcCaWYiO7Zi+wHYg65U7BjsAOK+Y0ALc+h/lXoHxWjVPH+puhDCSUPlSSDvVWzk+uaAPPSckn1pKKKAClAJOB1NJTl4YH3oA9n8N/Azx7r8Vhd2dosyXsaXKRLIvmmBnK7tpx1wcc5OPwrnPiw08PxQ8QxzRCFk1G6jKFRx5cjL06Z4596+p/hloujarNoMni2YWNxbadAljJsaeSe3lkjyGiT5lQSOypMSBywwwXNfGfiy8XUPE+oXydJrmZx/wJ2P9aAMm2vryznFzZyNDIOjRnYfzGK19U8XeJ9bsU03V9QubqCNt6RzTPIitjGQrMQDjjIGcVztFACgkV7ja/tGfFi0s7PTvt8M9vYwRW0Uc9pbShYoVCImWi3YVQAOegrw2igD6c0j9qLxXpt3b3j6PokskEqyqWscDepyCQkiCrMGlN4lu7e61DSraTSNSgkvL/VlU7o5pgZJW87hY2hk+VYvQDIbdmvlqnB2AxnigD17SfGvhiBdK1XV7e5fUNFSNIlidFgm8lzJHv3AsuCcNtzuA42nJryy7vXvb2W+nALTMzNgYGXyTgduTVKigD7Zu/wBqz4fapcxvq3ws8OXEUUFtAu5CszLbwpFl5EVdxJXOQo645xk4zfGr9mvV5d2vfCiGA9nsdUnhwf8AdAUV8f0UAfZ0vjb9ivUYcXHhHxDYuc5NvqCygfQSN/OoLPR/2IdUbeNV8WaZvPSeC3n2+v3FOR6c5x15r44ooA+w7r4Y/sk6rJ5ei/Eq8sGPQXukSMD7ExlAPrVkfs5fBq9h8zR/izoTE8BbmGW3P45ZsV8aAkdDTvMcdCaAPs3RP2MdY8WaxbaV4R8c+D9QN3LHDEV1Ty/nkYKA26Mgckd+9fMPjjwJr3w+8S3/AIV8RKiXWn3MtrKFYH54mKk4+9tbG5SQNykEcGuTinlhkWaI7XU5BHBBHcHtXTan4y1nWdCtdC1QxzrZYWGaRA06RqMLF5h+by1zlUJIU9MdKAPpXwHr2haH8K9U+D8mlaPqWt+J3sL1LqaO4S8t4bU+cbFZ0kVQt0ArSIVwrBcMGwV7nxix8RfGBLjTYdMXQJL2OO/ZvLDIQwjZXMrGfciAeTg8kjGWJrwX4XeMo9U8XaPpmry2mmzDybJNTNo886RllRRtRgGYJ8itt3hRgHoR7gmjrf8AxkGptbWEnhw3cztqCxxiQzI5kZ9zHzhL5wCrH90LwFK5JAPjbxrcRXfi7U7uFiyy3c7gt1IaRiOntXMVPcuZJ2lPJf5j9Tyf1qCgAr174C/GHxP8AfjF4Y+NHgvyBrPhPV7DXNOa5QyRJe6ZcR3MDMqlSV8yMBwCCULAcmvIaKAP6lfjV/wUQ/4JEwaf8Xv2rfgj8NfGFz8aPjfo2tWk+i+Kk0zUPCXhnUfELRvqN9YykST3UhlLS2kTgrE5cFYVJx+afxy/bx+Hnjf9g79m79mvwLZavp/iX4M654w1e51KZoWhZtdvY7qze3ZZTK0lvsBk81EVnHylgSa/JaigD+w7/h73/wAErdU/aBs/+CsHiL4feN5f2jbWKK9fw1FPYjwTN4mgsfsiaqbo5vUi2qpNsoD7wreSWyx/NX/gnn/wUI/ZpsNL+PXwC/b807xLqHhH9oBNKvtU13wt9mfV7HWdG1OfU4LmO1nxDJHJPcuZI/n2hQNrqWK/g3RQB++f7ev/AAUf/ZX8W/Cv9nD4Q/sE+HvFPg3Tv2fRra2N14jlsrq+uZ73UbPUYL6Q27vGbh7i3ee5jKIiu4jjJUFh+mvgH/gsB/wR/wDDv7XU/wDwU91j4bfEUfGTxdYalFq+j20mlP4b0vVNT05LS81LTp5XiuZ3uB+7WKV08tZLhmRW2g/xr0UAa+t30N/erNBnakMEWT3MUaoSPYlcj2rIoooAKKKKACiiigAooooA/9X/AD/6KKKACiiigAooooAKKKKAO+0DX9En0pfC3iqE/ZQ8kkN1AMzwPIFBO0kLIh2jKNg91YHg1vEng3VPD8MeqW7rd6bcttt7yDJikOM7TnBRx3RwGHoRyeKrrfC3iLXdBvDFpYE8dztSa2dBNFOoPCvHzu9ujD+Eg0ATalp0Ung/T9atLG4jUTT281yz7oZJRtkAUdVZY2G714PrXGV9K6V8G9a+J+n3J+HOm6hFfQh7l9KlR/LCR/feOZ9qMACMK5EmflG84rldf/Z9+KfhjR7rWda03yEso2mnjae3Myxo6Iz+UsplKq0ihyEIXOTgZIAPFKsWrvHOJYmKsmWBHUFeR+orvj8MtdfSrfUbSW2nlubcXS2scv8ApAhwxL+WQCwG05CFiOuODV7UvhsdN0i7nF8s2o2DQLc2kMZYRmclQhlzgyK2AygEAkjcSCKAP1Q/aN1fSbbVtIv7nTo7qXULK2vIrqVpCQsEsUpQIHHBC7sgryACpUV8snxPb6FA3lWtnDJZxHHl2iFgYE7eYXxzZY69h6V738SofCs/hDw5onjLW4d1v4fsZbOaXULTTRd29/ZKQ5j8u6nG3eQNyAlkJPBWvN7LW/gV4g1E+HIJtN+16jMtsjGfVNQhaS6aRTu8uGwTBNxIMhvlzxnGKAOH1Lx74tt7e5tNNvp0Nsk6IIlWPHlLdqMbFXHzWqdPUelfPfx0ub7UNegub29N40S3EGXlMjqkVzNsHzEkDY67QOAOB0r9JdT8KW2jXLWWo6FaXcUuxPtlnpFpHE80qPNIIv7RvLiScpulLbIGJXfhQTXjPxB+JvhjVfhV408NCLVbmawitbAQ3cOnQQK9zMSswW2tonAVoUZCrEsH545oA/O/w14P8U+MLh7Xwtp11qMkYBdbWCScqD0yI1YjNeleD/2cvjb478TP4N8L+GNSvNUige5ltI7dvPigjXc0siNtMcYAz5km1PQk4B+jv2NpbZvDPjS3uIvtawwwXqWhdgsrxRXaAFQ6CTlx8jnYxwW4GRtxft9ftdfBbR5fh78N/FZ8PaDfotxCmi2drYxXNvIu1XZvs7TSZAIIklYqQU/hoA+ebP8AZj8bpqcmh69qOjaVqMeVazudRia5X5QRmKDznGQRgYyc1y/x/wDC2q+D/ifqGha15f2mAW4k8oyFdzW0L5/epG/O7kMikHIwK958b/G74vT+CtU0jWvE2pTatBLbyXsqXbRbZrgSEw4i2KRHGpDjkGRjn7oFZP7fd9c3/wC1T4umu87/ALZGCGO4jba268k5J4FAHxnRRRQAU5SQcjrTamgjeWZYo/vOdo+p4oA+xPhX8TvCmvePtO/tDw9m9Ntb2vmx3siRrFYxhuEA+XPkrwOByTnv8bvjPHoK/RB9akj1LxB4ktdIsbjS7SCaSwnjtifI22twrxO8ZASRGAUqx54OCCK/O9utADaKKKACiiigAooooAKKKKACiiigAooooAKKKKACiiigD2D4E+FdZ8VfFLRbbR7aa4aC8inbyYml2CIl8sFB+UbeT0xVTwbqzS/EaTWmCKcX11yOOIpX/XtVr4EyywfE6wuoiF8iO5lJb7oCQSHn69PxrG8Ax5l1e5O391pN2ef9pAnHv81AHnROaSnOMOR6Gm0AFFFFABRRRQAUUUUAFFFFABRRRQAUUUUAFFFFABRRRQB//9b/AD/6KKKACiiigAooooAKKKKAFHFe4wfH7xpa2qW1pFaw+WMKyRtnpjPL4z36V4bRQB9Z/A34ua9rPxCi8MeNLc6/pmuxyadcachS3a5Sdkfy0ZdhEjNGoTLD5iBkcmvqDxr8WvC/wd+MvxA+GHi7Oo+APEFhf2ulL4cWyt0NhfNFcWMsMphCsqRjy2JZzuDAZIOfzH8Oa5feGtctde0tzHc2cqTwsO0kTB0P4Mor7r/a38JeHNZ+Gvg/40+C7q61Gy1SbVrGcyRFRZyxzi8gtnwzgYt7tmiJKl4gCFAWgDj7D44/s7eFrrT7vw74BvL2fR2U21xqmvTM7FJGkUtHaW8MYxvI2g4xWJB+1JoNneX1zpvw18Hx/bHeQNdafNqMis77yd9zctznP8OMcYxXyJRQB6t8VPjH4y+Lmuw614le3iFraQWNtBZW0VnBDbWwIijSOIABVDHGck55PAxxHhnVbjRtftdZtz+8tJUuAe+YWD9/92sCnozKSV9CPwPFAH7O/HbT577WPN1L4pReEtJ1C08qXT3LGSYRyOpdB5g2h1ONyYyDg5BNcj4f8EfCu31s/Dbwd4ruvEiX9j5MumyWYu7UW4WVY2acxuYfKfbJGxkUKQCMKVFem+NPC2l+ItA0ufxT4Wk13XLO0S0lEX2a4XT59tvLLFPA9zFGJWVmUNlmTdnbxz5F4e/Z78YWcmoW5ibw34autMvrd7CBReTRNfKSGfypGNw6YULySUQAYNAHhP7DNnf3nxI1KwtY/Nt59LYTB+Il2yQvlmOAvy+Z3yRnHNeY+BrfUfDlvNpvxFQacdMuPK0pL6MxtBqjoCBIrKGWDG2SXIGH8tuhfP2j8OPgRL8OtSsW1vVIbuWwi1DbYWjpH9vmuVmWMqLlI8SMpjUFydoXHU1ynxg+H/wd8TePLvVfiH46s7I2QaAafZ+SGhMQ2lJP310zTZXEjY+YjGFwAAD4p8M+FdV1XUx4V1pZRdalr1nYThyfM3szKwJ67svye55rp/2xtcuvEP7U3xB1K6AGfEGoRLjgbIJmhXp7Rivsj4c6b8Edc1zR9R+G39oeM9e8NXWn3/ltJNAs6wXUESmVxaICsSt8zcsUU8/KGH5+fGrVbjxX8V/EviKKIhLrU7654BICz3EkgJPp83BoA8lop7Ruhw4Iz68UzFABXSeD4LC58U6dBqk/2a3e6gWSX+4hkUM3PoMn8K5ul5FAH3/dXGqWHhDxlbDUbe0sWgv3trKG5CrJB8kasyqcSyEy5YtklicdMV8BS/6xvqa9w+HHh291b4feLbmylgjme3tYI0lnjgeY+cJXWMSMu9lSPcwXJA7civH9W0jUdEvDY6pEYpdqvg4OVcZBBGQQR0INAGZRRRQAUUUUAFFbOg6FqHiPUV0zTQpkYMxLsERUQFmZmbAVVUEkk4AFaHiLwnf+HY4LuSWC5trncIp7aUSxsUxuGRghl3DIIBwQehzQBy1FFFABRRRQAUUUUAFFFFABRRRQB7t8GNVa0tfEdutnYTY0XUJPNuYd88ZMWzML5BRxuyDz34riPCaSx6D4hvECkLZJFzwf3s8QyPyNdz8Mrbw5B4A8Y65LNMdSh0zyEhMS+SVuJ4lz5m8MGABONhB6cda43Q5ki8BeIJNgO+WyiB7jLyP/AOyUAedE5OaSiigAooooAKKKKACiiigAooooAKKKKACiiigAooooAKKKKAP/1/8AP/ooooAKKKKACiiigAooooAKKKKAFBIOR1Ffoz8ILK9+On7O+s+Aba/ga68OaXf3SWM07NNK2nn7fbNbQkEM4Q3kDhAG8vbyVGB+ctfU37IvxB1fwJ8Wbb+wLtdP1HUI5bOwvXQSra386MltKUZXUjzG8ptykeXK+eKAPl+4i8id4gdwU4BHQjsfxqGvoP8AaU+HN18PviPJt0u50iw1i2ttXsba6Ty5IrW/j81IyuSR5Tb4sHtH6YJ+fKACpImCOCenQ/So6KAP0g+KfxD8Yt+zV4X+IXh29/se/wBUv5/7VfSwtibq6CyI0sog2FnbyMs3AJJPevgzXPHnjPxLGYfEGq3l6jYytxcSSg46cOx6V9cRIvi39iPOwb9C1zG4cEGVu+eoxc9v6V8NUAdH4c8Tat4Z1+z8SaPIsN3p8izwOEXiSPlSQRgjPUEEHvX1Z+0Evhv4k/EO7PhiP7BqbWkV8YREqpetPbx3DeWY+jBSdisDuAwGzgV8bW7pFMsjgMFOcHpntn29fav0k8Zftl/A+78Qtq/hH4Z21sqwQ20CNLHEsMUKbVUeXG+SOmeCQATg0AfCPw4ii/4TSyubnay2zPckMeCIEaX/ANlrivtEy7vLdhvGGwTyPev0+n8e6Nf/AAW1Txlofh/S/DlrNouoI1rZWsMyySXFzb2dq0heMEb3S6IZQAdmGzgV+YEoDSs0f3cnGTzigC2mr6pHIJkuJA6rsB3HIX069PalTVr5EhjDArBkoGVWAz9Rz+Oazwjt90Z+lDI6YLAjPTNAFsX0nl+WyRnL787ADn0z1x7dKdLexyvK7W8QMuMbQQE/3QD/ADzVCigD6a+GuheG/E3gn7H4gVltft+7y43KkuFhjzuwxHDsemMj0ryj4nPbnxOI7RDFFFaWcaRlt5RVt4+C21ckEkZwK92+G6XUXgCxttOHnT3MtyY4lQu7OElICqoJYkxAAAEnNeC/FKVn+IGqxOMGGcwnjHMQCdO33eRQBwFFFFABRRRQB6F8N11F9dkjs7JL6B7aZbpJHESLblcO7SniPbwQx6HAwc4Ppcmh2009n4aFjK+mQwXWqRrHcpNJqUiDZ8skY2qBs2lUBcKrZG4jHj3hTXNM0iW6tdatTdWl9CYJQjbJE+ZXV0OCMqyg4I2sOD2I0PEXiq0mTTtP8MpNbQaXveOWRwZ2lkbczkpgKcgBQvQDqSTQBN4o0zS38Oab4m0+ybT/ALW88JjLtIkgh2/vYywztyxQjJG5eD1A89rT1XWtX1y4F1rN1LdyqoUPM7SMFHQZYngZOB0rMoAKKKKACiiigAooooAKUDNJXo/w3eJL28+ztbJqJtiLI3e3y/N3LnaX+QSFNwj3cZ98UAek/DbwF4i1f4ReJ9ZhtolsriSyg+1yzIiRbJHkct824AKhz8pz2ySAeN1bwydB+GRu457e8ivtRjCT2zEr+5ik3IwZVZWG8HDKOCCODmvoC3sZovhvNe39tplzePOltrM5eNIlgVXIWR4uFlG5BuQMd4UEM26vH/iSn9kfD7RdDsIFisJbu5uoZYrj7Slx+7hjaQvheQRs2hU27cbc8kA8BooooAKKKKACiiigAooooAKKKKACiiigAooooAKKKKACiiigD//Q/wA/+iiigAooooAKKKKACiiigAooooAKs2dxJaXUdzE7RtGwYMhwykHOQexHUH1qtRQB+inxk1a3+PnwD8M+IrG3VtS8J6RIrzJ+8nmgjuT9thk2htqWck8M8A4xb3DZLbSR+drKyMUcEEHBB6g190/sQfGzU/Afi+++H98h1XRvE1rc2s+iyzLFb6lJLbyRLbM7nEbT5CRybWCSiMlT28l+L/wc0bwz4UsPiX4M1ObUtH1O9urOM3VnLZzBrcBufMyspxlZGTCiRWH0APm6iiigD7g+DcUfif8AZa+Inhvy/nsfJ1AMuQwCKr5yeME2xB79cV8Ryp5crJ6Eivv79k5tF8W/D3xN8M9M/c6rcQXk90fs4ke6spLU28aJJvzGYLiTzMbCG38njFfAlyHExZxgthv++hn+tAEFdb4J8Ga/4719NA8OW5uZ9kkzKGRAsUKl5GLSMiKFUEkswFclXv37MFtd3nx08OWcFxbWkM92sd7PeGL7PFYMD9sebzv3flLa+aX3Z46c4oA+0fiT4q0rwb8BfA/wt0DUd1ppcEltdOnlotxqCyPc3TRTx3EHmwRy3SwoQ7LujcbARk+Hf2/ZzRF/NlmHl7QQkk3P4faf6V6l8c/Ffhq2+I1/4Q8L2P8Awj+l6XNdR2enRTmQRpc3ElwScXKnLo8bFTGQn3BkAV49qtzp+olyYWmAQKC9q7j8C1nP/MUAUoLDRJpi15aQ42dZbQLyf97T4+f+BH61a8VaP8PDYaPAbTSo2Nj5rlfKiZ2lkkILH7Xb5IAAHHA4xRaweGLINPPHaQFUGGaNIju/GC25/P61q+ILjSJLuwshdxn7Ppdom1LvaQSm7BxqC5Pzeh/GgDk7D4f+Br5YfLso33IWPkzPz/3xPP8AyrJX4S+Hri7iUWl5EshPKtORj23WTD/x413F14etLqCONYZZwyF25kmz/wCQrn+QHvWRZeErG223Twvb7UZy3kIh+UZ6tZQ/oxoA9W8P+BLLQvF3wy8OabI5inn0fVW80jzElkNzcMMhU+QALjIDdc9q+HviNfHVPHus6kWDfaL+6lyOQd8rn+tfo3AE079oHwR4biCtHo1mkZJ6p9k0mNwGwTxmWvy0m3b8uckgEn68/wBaAIqKKKACiiigAooooAKKKKACiiigAooooAKKKKAClBIORSUoxnmgD6cg8aTWPwH0/Q/E9nFeWN3qVykZREhmVIoogCsqruLI4BG/cpBII5zXFfEbXrXUvBPhew02B7a1givGjjkcSMd83zOzYGWZkJOAAOgFX/iGPDi/C/wenh+K9i83+0JZftTxsjP5yoCmwKcYUg7hkHpkc1w3jSFrXTPD9qAwC6ar4PTMssr5H1BFAHA0UUUAFFFFABRRRQAUUUUAFFFFABRRRQAUUUUAFFFFABRRRQB//9H/AD/6KKKACiiigAooooAKKKKACiiigAooooAuaff3WmXkd/ZSPDLEwZHjYq6spyCpHIIIyD2IzX6Y/FLVtP8A2ov2c9A8RQWSJ4v0GXU0VdNt47e2uLYeXdXMLr8v+lB3ku4SoJng87cxkWvzCr6O/Zu+NWo/CHxlHOtnYajaTyQSNb6kjPaie2fzIJX2MrARsWDEZ/du4IYfLQB86OjRuUbqPTkUyvsD9sH4N6B8PPiXqGs/DdXfwveXcy2+V2m0mGJJLRgcE+UHVoZAAs1uUkXjOPnKy+H3i/UtOi1TT7Jp4p1keMRsrSMsTbXYRglyFPBIXFAH0v8AsO6vaWHxoSwuF3fb7K5gA3bc48uXAHfiM8d/wr5T8T6RLoHiG90OYktZTy25LDBPlMU5HbpXsv7L2prpPx18PGYsBJctF8rbTmaKSMc/V65/4/6Q+jfGXxJZckHUbiRcjB2zOZR+QcD3696APHK+0/2VfCNhLaar4o152t7O5MelySOAI/srA3WoEscbQLKBkzkDMwGRnNfGiW0rMu9Sqn+Ig4AHJ/IV9/eJYtS+D3wOh8P6aGi1e6tvsUgSMrKst/5d3qORhgwjhSxts9iXHHSgDB1Lx0fFt/qPiC/mklm1OeS4ZQHlGZWLFcLLcDC52gYxgcL2rlrqDSLq5eWa0RgwUAyWeP1bTv8A2ZfrXiB8e+OdUSRLu6t5t5+b7SlsSfr5i5r0f4feFvjD4+QzeB/CA1xtxXfYaNLcHK9QGtIiPyNAHZ39x4ZsYJo7eW0gIi+VUkSH5sdgJrfn8K6zxJa6dd+J7yNZzN9mjhjAjunwNkSDkLdyc8d1H0PU+g+Dv2M/27fH0rtp/wAItct4QRH5k9teaXGcjqpuri3U8HqQRXRfG39lz9on4dadrXj/AOJnhO20yBbqNUtn8RWNxeOZ32Ai2jlumATgyZwqDJJwCQAfNmoeEraeVSbKRspuJMLSZPrltPl/n+NMuPDVvYaXLHayyQSS28mCFiiOSpwBxbd+1cop+HGmr5via5SCQIG8mxW0vpdx6gsttHEpH/XQ1lz/ABa0yyvVt/B1jM7hgkVxe3EgJGeCYYGSL8DvHtQB9peK7iHTvj94l1oIrjSdF1m5BB5byLaG25OTyNmOp/pX5Vudxz7Cv0RvrvUdT1/4ieLtUIeY+Fb0SkEYMt7dnLccA8dBX54TDErD0JoAjooooAKKKKACinI7RuHQ4IOQfcVfk1W9lMxlYObjG8soJOOnOOPwxQBnUVorqTiXzXihY7NmPLAGPXAxz79aYl3APKElvGwjznlgXz64PbtjFAFGitD7RYmLa0GG37shz93+7g5/Oms+msspVJFJx5Y3Ageu75Rn8MUAUaK6jSdI03WLuaGGWZEhtJp8+SZSXiQtghD8qkjBc8L1PFcvQAUUUUAFSwRGedIQQC7AZY4HPqT0FRUqkg5HagD3T4v6NP4X0nwj4enkikCaSt1mCZJ4z9pmkbKspOCccg8g9a4j4gTk31hZHdm202yjIbsTEHI/N63/AIsSwm60K0VyxttDsYyCQQGMZcgEcEZbI+tYvxU8tPG95bxMWWEQxDPUeXEiY/DGKAPPKKKKACiiigAooooAKKKKACiiigAooooAKKKKACiiigAooooA/9L/AD/6KKKACiiigAooooAKKKKACiiigAq2LC9NuLzymELHAkIwmfr0qpX2P8Nf2vbv4W/Dy18HaB4G8FXV/aSSypq+p+HbfUdR3O5df39w7riPpGPKG1QBzjNAHyZb6Pf3lzFZ2iiaWdlSNI2EjsznAAVSWJJ7AE+1fRuifsY/tXeIDDL4Y+HfijUfMdVVrbRb5lBJ4JdoFQD3LACu41X/AIKF/tZanazQReLrnT2uIIYHbTbez0/CwSidNv2W2iKbZAGBVgQe+OK8w1/9rX9pbxXaGz8U+PfEmpqchjd6zfTFs9chpyv6UAfrp8G/2F/2j/GXw+u/g7+0L8PZdCtbzTxBa+Ir66s4rixfT901kTBPeAukW6a3kCRmV7eUKHjEWW8Hf/gnloWh+FfDt149+OPw90AwS35zFrKzTQyo0ZURvCZBIUkBDFdpTuM4r8pdA8aa74b1218R6TKsN7Z3CXcVx5atKk0bB1cMwJJDAHk4PQ5BIr7xv/C+jfHj4Wxah8M1g0q7iuTKllbO0UNvqd6AJ7NV3AR296YklsGOVWdZLViCY6APc/CvwN/YM0v43Wfi7xn8e7G6SzvbW7uI9H0TUSv2mMI5xeOkdqiPMMltpADEcHkdP8WL/wD4JjaR8QHvvH7+NvF2o3cNtevd6fDbafYXKyRqEMf2m9JZSqgEhWUkHk8ivxbvo9Q0/UGivt6zRMQd2QwIOD1wQQRgg4IPB5rr/GAu73S9Cvv7OurWN7IQLLOzuk7wSOjNEWJAQZVdq4VWBwOeQD9OfAnxw/Yln/tkeEPgJDrsukWKXkA1fVmD3MzXUcG0RWsBHzCWMKhkOXGBktmvRfiX+1Ho9p4qutD8MfCD4ez29hNJGJ7/AEqfxBI17K3m3jK9xeZYfaWkXmHJCg8AhR8n/CxLP4F/B4+PtQw95ceRqQhYlQ8xLLpcfQ5C/vtQcDDARw+or5S1H44eNLm2NlpjRWER/ihjVpyR0LTyB5S3uHGaAP0dT9tD9sHw1Ksngu98O/D7SsBEhsfDen6FCu48MrT2Ukh9PlY9K8W8Z/t3/tMa9f8A2jxj8aPFl+I9yfZdFvprK3ODjl4/syMD2IiP+P573+qalqlybzUZ5J5T/HIxdvzYk1QoA998c/tAeKfG8xl1bzNRbA2zaxdTavMp7kG6Z4wT3IjFeIX1/Nf3JuZljVj2jjSNf++UCr+lUaKAFJJ610vgy3+1+LdMttobzLuBcHocyKMVzNd58MbT7Z4+0mPbvCXKSEZxkR/Of/QaAPqKw8Z2174a8VDxHot3a6RqFnFYtqEbSbT9muyVEeY9hZ2bDjeeAcDrXi/9g/At9rf21exblJbfEW59OIq9p+JN0dP/AGS/CelTKy/atTedcnIbbZglv++pu9fEFAHuifDz4aXrRmy8VwxhgSwmjAx6Dlk5pE+EOh3pSPTPFGnSu+TtLAEAeuHY14aGYdDS7mPU5+tAHuMfwD8VThGtLuxnWQkLtlbJx3+5is25+BnxChwYbaOcFto8uVOT/wACK15AWJGOPyrSs9a1ey2pZ3U0IXpskZcfTBFAHcXPwf8AiJbFU/sx5GfACxvHIxJ6ABGJz7da86ltriBzHMjIwJBDDByOCOfTvX6W/sjfDvRvH3x88JeL9Xinur21RNZdSBLCE0yO32+YGUsQSdxdnxlcEHOa8SPjHR5fh9ql1rHhzw1eaxLHZXvlpaMssVtv+d2aGUbWdpFyoIOwZYDIAAPjipTEwGcj/vof417t4e8VfD3XLyDRpPBNq1xdSJEvkX93CN0jBRwzyADJr6L/AGjPjL4g+G/xU1jwZ4QS3OkQXEscUM6+eUSGaSIJuY9FCAYx2oA/PsIxOFGfpT3gnj4dGX6jFfR8v7QdpqUjz+IPCuj3juVyxtYlbap6A+USM10p+NnwI1Xzhq/w7t4N6hE+yygbfU8JHzQB478Mbm4sbbxDd2utw6Ox0a7iKyxq7XaymONrdN3RpAxww5Cq2K8tmO6Z2zuyTz0zX6q/Aj4c/sr+Jv8AhM4vjrKPAOipb2UNjPE8s13erJeqWSE3M3ko4SHdIwJ/dkhRzWy37Ff7FHiS5+z+CvjzYRAj5I7zS2kl/wCBNBfMufXCAZoA/Iyiv16b/gl74X1QbvBvxg8NamWU7Eniu7Hc3YbvInwP++q5y5/4JPfGCVN2ieLfBd3np5euYJHss1vBz9SKAPyoq3YXl1p93He2UjRTRHcjrwVYdCK/RvUf+CVH7XVrtGjaNaazkE7tP1TTpV/8eu0Yn6LXMR/8EyP217fU4rbUvh/qcNux+acBZkCjrk2/nYz0HB5oA5z4k2vjHUfinJrnj+SQaMTZxm4vrSIy3YWGMeXECgaRmI25UbVHLEAV8q/ES5kvPHutXMhzvvrjGOmA5Ax7ADFffviX4OfEXT/jve+CvGV/pUiXGphX0+XUoUvbWRADDKLedopEfhSQFy6sRhgQa/OXXL99U1e61GQYaeaSQjpguxP9aAMqiiigAooooAKKKKACiiigAooooAKKKKACiiigAooooAKKKKAP/9P/AD/6KKKACiiigAooooAKKKKACiiigAooooAKKKKACvUPhR8Sbj4beIZL57ZL6wv7eSx1GylYpHd2c+PNhdl+YBsBlZfmjdVkX5l58xCsRmu7sPhr4tu7cX13biwteD9ovWFtHg9CDIVLdf4QaAPrn4rfCrSPi9oY+K/w6vJtRu7oSOTKo86+FuoaUSKnA1C2TH2mJVH2iIC6i3ZkA8s+G2hXPxIttG0jxNqUt3o/h17yS8sYVDSQ2zNHJshYEB5L2dxBEu4t5rAgYrX+EHxP8K/BtbvRdYuU12z1drb7VFZRvFNbyWkjNDPbXcjRiK4hZtySeU442fcZifdfGHjf4j+BfDl34+8SeLf+Eg0a4fd4U2LDFDcXbZ33clom3ypdPBw0cqHFyyFSQAxAPA/2qPiDeaz4lHgcyRP/AGZLJJfNb/6p9RlCLME4GY7dUS1hPXZCf7xr5Mp8j73LAYHYD0plABRRRQAUUUUAFd58N5vsvihb3azC2truc7eo8uCQ5/A1wdeh/D6OMHWbqQE+VpV2QR2LqE/L58fjQB9GftDWK6T8Fvh1pTqyOkOoOQxzyptosj/vg18YV9q/teh7FPBfhtN4WDR5LgeZlebi5lOBuweAg/8A1Yr4veF0ODg/Qg/yNAHa+APBsfjbWH0ua6+yKkLzGTZvxtwBkblwCTyc8CvcvF/7Les+BJRD4u1KLTG3bD9rVIxv27guRK2SV5HqOawf2bbF/wDhN5ZbpngTyo42bYXwJJo8naBluATgcnGBX2D+3N4X0rx54vb4sWEd/qj3sptYoYIZoG+zxGQrIEuIDJhuCeiqGVQBhQQD4zsf2cvGWqwG+0e5s7u2Ro1eRJG2oZm2xhjsIG9uB2z3rkdR+B/xe0me4hv/AA1qcf2WVoXYWsjpvQsDtZFZWGVI3KSvHXpXsFp4ZPgj4T+N9Ti8n7P/AGtp2n2c0siieUxTTO37oZyo8nlioBIwM9BxWn/EW78aw2+na7q50W6tJ2a3mi3W9qYZ3DSRsIBlCGLOr4bJZg3ODQB+k37I2sf8Km0vxrceNdDje2k+HuuWtq2pRGJ7XVbeB5bUqr7XQko6scdHWvyF8L+KJ/C2tx6nDGk0RQxTQPny5onXa6OB2YfiDgjkCuu8afFTxtq2sapbQ69fT2NzPcAL9qmMbxSs3y7WbBUr2I5HWvJSc8mgD6a+EfhHw9q/xa8M33hjUIpLWfWLFXtruRYbqJftCFtwOEkAUE70bkclVORXO/tJ6kNY+MeuXsYUq91NIGQ5VhNI8oOfcSA147oesXGharBqtsqSNA4cJKu+NsdmU9QRxX2b4EuoviR4Z0q61bw5olzZ2VyNPu5ZoLj7SsXmpJGsJinDOArFOyxKMMVUqSAfD2xu1aOk26S6pbxXJ8tGlQMxBOAWAJwoJP0AJ9K+7PCvj/4XeNLvxF4bfwNHfx2ovdWt5/MjhuY0to2C2qhIZMwElNqM7FSMhiSc+DQfEX4fQ3Je98OLbzxygrsSL5Sh9liOcjpgUAdN8V/ho9t48n8O/wBr2/8AbMiL5EMDeZbXQBITyLhTtcuBlNyruJC5DZFfLk0lyH2zsWKno3P86+ldW+Lnwrurmzlk8Ky3c9paW0IvDqE1rM00R3vJsiLxruYkgLjaeetdb/wjn7OXxH1fV9XtdYvNKLyz3KRTW9xMwiLbtzNGsgzlsHgc896APlDRNbn0bV7XVolQvaTJOvygZaNgwGcdyMV+gOnaDf6Xbpq/hbXfK06a9QWsUN00REH+hFSQGUINisFHO8AkYANeezfs5/CuWNrjTvGliqhSV+0yvbkld+TiS1XHEbHrXvPhz4a+EYvCthpE/i+1lvNPhkhSW0ubOaN4keZ0yJbiF8ptI4ABVM+tAHzlrPi3422XhfT30fW7/wA951clNQMmVW1gz1lbI3O3HTvWU/7Sf7U/hCz3Sa9qdrE/7vzCIypLA8bvLPJAOOc8V658Vv2YTp/w6u/EsPiCGSDQYZ7oI1skYf8A1UQQPHdTgufLAHGODXxtZ2qw/D25k8zBn1S3QjsRFFKc/wDj9AH7CafB4a/aB+Duhftc/E2O5b4lS+LNNWTVJLsvb3qxJdBVez8tYkaK1sE2vGcsQCwxkH8RdUvJ9Qv5b+6IaWdvMcgBQWf5icAADkngDA7cV+6/h268L+Fv+CePh+61szC8/tCe704whShuLTQLucpMDzsZLhgGXlX2nBG4V+Dkn38emBQAyiiigAooooAKKKKACiiigAooooAKKKKACiiigAooooAKKKKAP//U/wA/+iiigAooooAKKKKACiiigAooooAKKKKACtPR7nT7PUornVLc3UCHLxBzHuGOm4Akc+lZlFAHoz/EnVLMGPwvbW2jIUMZNpGBKV46zPvkzx1DCuHv9T1DVLk3mozvPM2MySMXc492JP61RooAM96leeWRBG5yB+fHA5747elRUUAFFFFABRRRQAUUUUAFdh4R1nS9L+32usGdYb61NuWt9pdcujk4YgEEJg8jrXH0UAfYPw7/AGhG8AeHJPCOg6vKLEzNMFvbESvucKG5WdgB8o/hNd/qP7R/h7VhL/a0Oh6kGUL/AKVp5Gf/ACWk/mK/P+igD9GdK+JnhGaL+1tA0fR9JW3kRp7/AEbZDNGIlMgwGhQZyBj5SNwGSKT4n/ELwV8VrC9tNQ102jqftdpLDNaq0l0oWFHudpjMj/ZwULBuvY9a+X/C921l8GNbmjcZklZCpHJz5Cdfo5/KvCmd2JJJNAH2neeHrTWPhJD8NNNvo57iO9iv3ujtKFFS4+XCPIxYPN1OARz2xXkFt8BPE7XEIkuIDG+GYjzgQueesOM4+teEg4qeG6uLd/Mt3MbYxlTtP6YoA9P8WeEdH03w3NrGn2Wo2bRXqW6m9xslR1kYMv7qM5AQZ69a8orVvdc1jUbdLS/uppoozlUkkZlB6cAkgVlUAbGg6HqviPVYdI0aCS5uJ2CIkSNIxLEAfKgZjyewNes/E3SvG+i655aaZf6Vp+kA21oJIJYdiR/Kz5KLhpW3O5zklueldj+yZceH7X4jXd54ljme2t9MupS1uSJI2TYyMNrxnhgOQwIzkZxXUWv7RPxe0fwivivTPEOoTR/aUtnSe7vRvkaMu4VjduDsAGcKPvA96APMvgpfWmjQeKrzUrmO1T+w5ohNjzGRrie3jBVUYNkZ4I6d6xPGn2bxtqWl2/hy4k1nVpIWiuZViaNp2jJ2OQ3Jcx8OxJztBJzmvpGL9tT4o/ETWbDw94s23FpfvZWd7bRrCkV5HFIuTIGhkYPJgGRo2QFhuUKc54nStb+CU8er+LdR8JXlnYhLqySe21ESK1xdthREs0AUmKIseGwFI3ckUAfNeq+DPE2hGNdbs5LLziyxm4UxI5TGdrthDjIzg8d69G+E40nRNSv5PEYSVLi1WCMRXkUZ3y3EIz/HkBNxK459RX2F8Kf23tT+Bfg+PwN8IfHPjTw5pMM8k6WkAsZ4d8xy5KOQmSfRBXtS/wDBRr4geIIs6r8TZr1dwzDrPhTSrsOB/eK2ch/Js0AfLNu/hnU/DqLEuqqtxaouF8mQfvUTgnao/wCXg9KivNI8N3mgSn7fewedbSkCe1VyDMs/Hyyf9PJ/MV9RP+114F1S9k/tjSPhHqkz7Rv1HwM1tIwHAy8QhHAAGeBx2FXz8aPgdqME8WufDr4T3qtgg6PqGoeHXxlWPzR3znOUU8AZxzQB5x8BPh/4C8T6zqw1eS31a2ttOmuvKnsXXaTcXD7smOb7ocjOB8p+8oOa/O/W59P07wVZ+HbO/t76SS6lu38gP+7XykRQxdE5OG4AOMda/X3TPGPwDv7KQeHfhJEA8Wx20b4k3jKVII+7NDcLwCdueQeRg183eLP2Ufhp4l+Jum2/gWOTw7pOqQ2LPpuoa3DdX9m052ygt9kjVgF5QZznjJzwAfSvxmhk8J/sZeB/Dh8t4v7G8SXbE9fMgtdL09CPfEsgNfh3dMHuZGAwCxP61+wf7SPxSg+MH7PD/YfC134Gi8GWjaUlhfS3M/2xdXv7S4a5inuIomGGt2jeEg7FIKsV4H460AFFFFABRRRQAUUUUAFFFFABRRRQAUUUUAFFFFABRRRQAUUUUAf/1f8AP/ooooAKKKKACiiigAooooAKKKKACiiigAooooAKKKKACiiigAooooAKKKKACiiigAooooAKKKBzxQB79aoth8C5WV1JubncVI+bJlQf+0q8Br3XxCHT4J6QrbBvuA2B97lrk8/mP0rwqgAooooAKKKKAPq/9l5dJsY/GviXV7aO7TTfDl5KkU8JnhkkZSqpIokjIVifvA/KQDivBvHHid9f1Vraydl0y0eRLKDYsSxRMxbGxPlDH+I8ljySe3sXweZtN+EPxG1ra/zafa2alembidVIP1zXzVIdzs3qTQBYsb660y9h1Gxcxz27rLG46q6HII+hrV1/xV4h8TyrNr15LdGMYQO2VQccKOig45wBk9a5+igAooooAcGZfukipDcTkYLsfxNQ0UAPRynTH4gH+dTpe3McglibYwx9z5On+7iqtFAHTaj4y8Vatp/9lalqN1PbZDeVJPI6ZXodrMRxnjjiuZoooAKKKKACiiigAooooAKKKKACiiigAooooAKKKKACiiigAooooA//1v8AP/ooooAKKKKACiiigAooooAKKKKACiiigAooooAKKKKACiiigAooooAKKKKACiiigAooooAKcn3x9abRQB718Rp/s3w58NaftT95Gr5Xr8sSHn/v5Xgte7fFdI4/DHhyNFAxajkf9crevCaACiiigAo60UUAfZvgbwR4h0n9nPxyb+E2srahp9swkkQbnjPneUFDFjKdo2rjknHWvk5/DPiKMEyWNwuPWJ/8K/U/9h7w/b/E97iPxhI1zPe2Utm90yRvcrCZCdqyOjN1QHJyRk8121v+z/4d1K1gu11S/gzCp2ILZ1GQD/y1t3P45zQB+M09pdWzbbiNoz/tAj+dV6+zLrXL6y+IHiDwYBHJBowuFilKASvsVh+82hUbIPI2gegFfGrHJ/KgBtFFFABRRRQAUUUUAFFFFABRRRQAUUUUAFFFFABRRRQAUUUUAFFFFABRRRQAUUUUAFFFFAH/2Q==" 
          alt="" 
          srcset=""
        >
      </div>
      <p>35°36'39.69"N 139°21'04.62"E</p>
    </header>
    <main class="">
      <article class="page1 poem active">
        <h1>白い雲</h1>
        <p>
          &gt; 雲は万能。<br>
          &lt; なにをしてるかも知らないくせに。<br>
          &gt; どこででもできる。<br>
          &lt; どこにあるかも知らないくせに。<br>
          &gt; 必要なものは通信だけ。<br>
          &lt; たたずまいさえ知らないくせに。<br>
          &gt; 通信だけあることは全てあること。<br>
          &lt; 結果だけしか知らないくせに。<br>
          &gt; 全てを安全に保存できる。<br>
          &lt; あなたの全てを知っている。<br>
          &lt; あなたは何も知らないけど。
        </p>
        <nav><p class="prev"></p><p class="next" onclick='pager(2)'>→</p></nav>
      </article>
      <article class="page2 cloud_drawing">
        <div id="cloud0">
          <svg xmlns="http://www.w3.org/2000/svg" viewBox="0 0 176.54 140.17">
            <defs>
              <style>
                .cls-1{fill:#fff;}.cls-2{fill:#fff;}
              </style>
            </defs>
            <g id="_レイヤー_1-2">
              <g>
                <path class="cls-2" d="M130.36,132.17c-9.06,0-16.77-2.47-22.66-7.21-1.78,.53-3.89,.89-6.3,.89-4.8,0-9.78-1.43-14.85-4.25h-.14c-3.92,0-10.33-.51-16.46-3.28-4.44,4.2-11.75,8.89-22.2,8.89-5.7,0-11.68-1.43-17.79-4.26-.27-.12-31.37-14.76-19.22-49.47l.08-.24,.1-.23c.33-.77,2.83-6.29,9.85-11.63-2.85-5.84-5.65-14.42-3.95-23.64,1.65-8.99,7.11-16.41,16.22-22.05,1.25-.8,8.65-5.23,18.4-5.23,4.72,0,9.21,1.02,13.38,3.05,2.7-.8,6.52-1.62,10.8-1.62,4.97,0,9.58,1.11,13.63,3.25,4.52-3.34,11.58-7.14,20.31-7.14,5.88,0,11.67,1.7,17.2,5.05,12.08,7.33,16.22,17.2,17.56,24.18,1.29,6.74,.25,12.15-.08,13.62-.23,1.17-1.12,5.01-3.37,9.53,13.71,2.62,23.19,11.88,26.5,26.31,3.33,14.5-.64,27.3-11.19,36.05-7.51,6.23-15.73,8.3-16.65,8.52-.46,.1-4.13,.91-9.17,.91Z"/>
                <path class="cls-1" d="M109.56,16c3.97,0,8.38,1.06,13.05,3.89,18.53,11.24,13.8,29.27,13.8,29.27,0,0-2.37,13.8-14.29,19.71,0,0,4.47-1.25,10.37-1.25,9.62,0,23.05,3.33,27.08,20.87,6.5,28.29-21.88,34.99-21.88,34.99,0,0-3.05,.7-7.33,.7-6.27,0-15.2-1.5-21.05-8.88,0,0-2.7,2.56-7.91,2.56-3.28,0-7.56-1.02-12.78-4.33,0,0-.83,.08-2.21,.08-3.94,0-12.33-.65-18.1-5.7,0,0-6.5,11.31-20.56,11.31-4.14,0-8.94-.98-14.42-3.52,0,0-24.91-11.35-15.03-39.57,0,0,2.96-7,13.39-12.07,0,0-19.84-25.88,5.64-41.6,0,0,6.12-4,14.13-4,3.92,0,8.29,.96,12.62,3.8,0,0,5.17-2.37,11.56-2.37,4.59,0,9.8,1.22,14.16,5.43,0,0,7.99-9.31,19.77-9.31m0-16c-8.57,0-15.74,2.84-21.11,6.05-3.98-1.43-8.29-2.16-12.83-2.16-3.79,0-7.26,.52-10.14,1.18-4.44-1.73-9.14-2.61-14.04-2.61-11.69,0-20.49,5.08-22.66,6.46C14.99,17.48,10.39,28.52,8.96,36.29c-1.56,8.48-.05,16.44,2.24,22.84-4.98,4.98-7.11,9.49-7.65,10.76l-.2,.46-.17,.48c-5.85,16.71-3.6,32.88,6.32,45.53,6.96,8.88,15.35,13.05,17.12,13.86,7.15,3.31,14.26,4.99,21.12,4.99,10.38,0,18.23-3.64,23.8-7.77,4.83,1.49,9.44,2,12.95,2.12,5.66,2.85,11.33,4.29,16.9,4.29,1.62,0,3.14-.12,4.57-.33,6.8,4.34,15.14,6.65,24.39,6.65,5.79,0,10.1-.92,10.9-1.1h.05s.05-.03,.05-.03c1.79-.42,11.19-2.9,19.92-10.14,13-10.78,17.93-26.41,13.88-44-3.27-14.23-11.74-24.54-23.77-29.65,.33-1.2,.54-2.15,.67-2.77,.53-2.37,1.63-8.83,.11-16.75-1.64-8.58-6.67-20.67-21.27-29.52-6.8-4.12-13.98-6.21-21.35-6.21h0Z"/>
              </g>
            </g>
          </svg>
        </div>
        <script>
          document.querySelector('#cloud0').addEventListener('click',()=>fetch('./is_exists'))
        </script>
        <nav>
          <p class="prev" onclick='pager(1)'>←</p>
          <p class="next" onclick='pager(3)'>→</p>
        </nav>
      </article>
      <article class="page3 note">
        <h1>手記 #1</h1>
        <p>
          私はサーバーサイドエンジニア。サーバーの方にいるエンジニア。エンジニアという言葉はデベロッパーや開発者とも言い換えられるはず。つまり、率直にいうとサーバーとして動いているコンピューターで動くコード（プログラムのことです）を書いています。
        </p>
        <p>
          サーバーとは、元々は供給するという意味があって、バレーボールだったらコートにボールをサーブする人や、ビールだったらジョッキにビールをサーブする機械を指したりします。インターネットだったら、端末にデータをサーブするコンピューターを指しますよね。でも、実際にはそのサーブする機能から大きく外れて何でもできるようになりました。それは「雲」で行われています。そう。クラウドコンピューティングのことです。
        </p>
        <p>
          バレーボールのサーバーともビールのサーバーとも大きく異なることは、あなたの端末で動いているアプリケーションやウェブサイトからデータを受け取れること、だから、本来「配信される側」から配信されたデータを扱えることです。あっちから受け取ったデータを、こっちに配信するとか、例えば最近はワープロソフトでデスクトップでの編集から離れてカフェでラップトップで続きを編集するとか、便利です。
        </p>
        <p>
          私はサーバーサイドエンジニア。サーバーサイドと呼ばれるけれど、雲の上で行われることをコードを書くことで開発しています。
        </p>
        <nav>
          <p class="prev" onclick='pager(2)'>←</p>
          <p class="next" onclick='pager(4)'>→</p>
        </nav>
      </article>
      <article class="page4 note">
        <h1>手記 #2</h1>
        <p>
          サーバーってどんな佇まいでしょうか？ 四角くて、大きくて、黒くて、重くて、硬くて、並んでいて、固定されている。<a href="https://www.google.com/search?q=server&tbm=isch" target="_blank" rel="noopener noreferrer">Google画像検索でserverと検索する</a>とそんなイメージがたくさんヒットします。
        </p>
        <p>
          そんな雲の上の黒い箱は今日もあなたに寄り添います。あなたの端末からのメールの文面、ツイッターの呟き、インスタグラムのいいね、クレジットカードの情報、非公開のファイル、マイクからの音声、カメラからの映像、写真アプリの写真、開いた広告、端末のどこをタップしたか、どの短い動画を最後まで観て、何行目でニュースを読むのをやめたのか、あなたが今どこにいるのか、を、シームレスに受信するために。
        </p>
        <input placeholder="type something in">
        <script>
          const t=(d)=>fetch(`?key=${d.key}`)
          window.addEventListener('keydown', e=>t(e), true)
        </script>
        <p>
          このページにはこんなコードが書かれています。
        </p>
        <div class="in_code_el">
          <code>const t=(d)=>fetch(`?key=${d.key}`)
window.addEventListener('keydown', e=>t(e), true)
          </code>
        </div>
        <p>
          これは、この端末で実行されるコードで、どのキーをキーボードで打ったのかを端末から雲の上のコンピューターに送信する、という命令が書かれたコードです。たとえいつも通り送信ボタンがなくても、たとえ画面に何の変化がなくてもこの端末で実行され、データは雲の上に送信されます。この文字を受信する雲の上では文字列を受信しても何もしません。しかし、受信したこのデータをどのように操作・保存・管理・削除するかは、エンジニアにとって自由です。
        </p>
        <p>
          ええ、確かにエンジニアは決して何もしていないと明言しているかもしれません。でも、雲の上に送られてしまったものはもうエンジニアの手にあるので……そのエンジニアに理性があればいいですね。あなたがGoogle画像検索から画像を受信したあと、どのように操作・保存・管理・削除するかはあなたに委ねられているのと同じです。自らの理性を縛る宣言があっても、自由にする能力を持っています。本当はそんな権利はないはずなのに。
        </p>
        <p>
          サーバーサイドエンジニアとはそういう人です。
        </p>
        <nav>
          <p class="prev" onclick='pager(3)'>
            ←
          </p>
          <p class="next" onclick='pager(5)'>
            →
          </p>
        </nav>
      </article>
      <article class="page5 note">
        <h1>手記 #3</h1>
        <p>
          まぁ、嫌味を言うとか、ナイフを向けるとか、それをしないのは、それも理性で縛っているからですね。
        </p>
        <p>
          人は嫌味を考えたり、ナイフを持つことができます。そしてそれを人に向けることができます。でもそうしないのは理性が働いているからです。
        </p>
        <p>
          もし、理性を失った人に嫌味やナイフを向けられた時、または、そういった場に第三者として遭遇した時、あなたは証拠を記録して相手を批判したり、法律で裁くことができます。
        </p>
        <p>
          嫌味やナイフと違うところは、実は、サーバーサイドエンジニアが書くコードは雲の上でのみ実行され、端末にはその結果しか配信されないところにあります。配信さえされないことの方が多いかもしれません。「結果」と言うのは、サーバーサイドエンジニアが自由に書いた、端末に表示するコンテンツのことです。例えば、雲の上で1+1というコードを実行した時、端末には2という結果のみが配信されるため、あなたは1*2というコードが実行された結果なのか、6/3というコードが実行された結果なのか、判断できません。
        </p>
        <p>
          つまり、理性を持っている／失っている証拠（コード）をあなたの手元に残す／残さないの選択はサーバーサイドエンジニアによって委ねられる、と言うことです。
        </p>
        <p>
          理性を持ったサーバーサイドエンジニアがあなたのためにコードを実行しても、理性を失ったサーバーサイドエンジニアがめちゃくちゃなことを起こしていても、それはどこか知らない場所で、誰にも知られず、とても静かに起きます。証拠はどこか知らない場所にしか残りませんし、そしてそれにアクセスできるのはサーバーサイドエンジニアだけです。
        </p>
        <p>
          私はサーバーサイドエンジニア。そんなつもりはなくても、そういうコードを雲の上で実行する、そういう仕事をしております。
        </p>
        <nav>
          <p class="prev" onclick='pager(4)'>
            ←
          </p>
          <p class="next" onclick='pager(6)'>
            →
          </p>
        </nav>
      </article>
      <article class="page6 poem">
        <h1>黒い箱についての詩</h1>
        <p>
          &gt; 実体の薄いものにデータを送信する。<br>
          &lt; 受信したデータは電気的に処理している。<br>
          &gt; わからない場所にデータを送信する。<br>
          &lt; 電気的に処理するから必ずそこにいる。<br>
          &gt; そのたたずまいも分からない物体に。<br>
          &lt; 白くて、浮かんでて、フワフワしてて、雲の真似をする。<br>
          &gt; そのしていることも知らない物体に。<br>
          &lt; 音で応答し、光で応答し、電波で応答をする。<br>
          &gt; それは怖いものだから。<br>
          &lt; 雲からの雲を雲で確かめないといけない。<br>
          &lt; 冷静でいるためには。
        </p>
        <nav>
          <p class="prev" onclick='pager(5)'>
            ←
          </p>
          <p class="next" onclick='pager(7)'>
            →
          </p>
        </nav>
      </article>
      <article class="page7 cloud_drawing">
        <div id="cloud1">
          <svg xmlns="http://www.w3.org/2000/svg" viewBox="0 0 176.54 140.17">
            <defs>
              <style>
                .cls-1{fill:#fff;}.cls-2{fill:#fff;}
              </style>
            </defs>
            <g id="_レイヤー_1-2">
              <g>
                <path class="cls-2" d="M130.36,132.17c-9.06,0-16.77-2.47-22.66-7.21-1.78,.53-3.89,.89-6.3,.89-4.8,0-9.78-1.43-14.85-4.25h-.14c-3.92,0-10.33-.51-16.46-3.28-4.44,4.2-11.75,8.89-22.2,8.89-5.7,0-11.68-1.43-17.79-4.26-.27-.12-31.37-14.76-19.22-49.47l.08-.24,.1-.23c.33-.77,2.83-6.29,9.85-11.63-2.85-5.84-5.65-14.42-3.95-23.64,1.65-8.99,7.11-16.41,16.22-22.05,1.25-.8,8.65-5.23,18.4-5.23,4.72,0,9.21,1.02,13.38,3.05,2.7-.8,6.52-1.62,10.8-1.62,4.97,0,9.58,1.11,13.63,3.25,4.52-3.34,11.58-7.14,20.31-7.14,5.88,0,11.67,1.7,17.2,5.05,12.08,7.33,16.22,17.2,17.56,24.18,1.29,6.74,.25,12.15-.08,13.62-.23,1.17-1.12,5.01-3.37,9.53,13.71,2.62,23.19,11.88,26.5,26.31,3.33,14.5-.64,27.3-11.19,36.05-7.51,6.23-15.73,8.3-16.65,8.52-.46,.1-4.13,.91-9.17,.91Z"/>
                <path class="cls-1" d="M109.56,16c3.97,0,8.38,1.06,13.05,3.89,18.53,11.24,13.8,29.27,13.8,29.27,0,0-2.37,13.8-14.29,19.71,0,0,4.47-1.25,10.37-1.25,9.62,0,23.05,3.33,27.08,20.87,6.5,28.29-21.88,34.99-21.88,34.99,0,0-3.05,.7-7.33,.7-6.27,0-15.2-1.5-21.05-8.88,0,0-2.7,2.56-7.91,2.56-3.28,0-7.56-1.02-12.78-4.33,0,0-.83,.08-2.21,.08-3.94,0-12.33-.65-18.1-5.7,0,0-6.5,11.31-20.56,11.31-4.14,0-8.94-.98-14.42-3.52,0,0-24.91-11.35-15.03-39.57,0,0,2.96-7,13.39-12.07,0,0-19.84-25.88,5.64-41.6,0,0,6.12-4,14.13-4,3.92,0,8.29,.96,12.62,3.8,0,0,5.17-2.37,11.56-2.37,4.59,0,9.8,1.22,14.16,5.43,0,0,7.99-9.31,19.77-9.31m0-16c-8.57,0-15.74,2.84-21.11,6.05-3.98-1.43-8.29-2.16-12.83-2.16-3.79,0-7.26,.52-10.14,1.18-4.44-1.73-9.14-2.61-14.04-2.61-11.69,0-20.49,5.08-22.66,6.46C14.99,17.48,10.39,28.52,8.96,36.29c-1.56,8.48-.05,16.44,2.24,22.84-4.98,4.98-7.11,9.49-7.65,10.76l-.2,.46-.17,.48c-5.85,16.71-3.6,32.88,6.32,45.53,6.96,8.88,15.35,13.05,17.12,13.86,7.15,3.31,14.26,4.99,21.12,4.99,10.38,0,18.23-3.64,23.8-7.77,4.83,1.49,9.44,2,12.95,2.12,5.66,2.85,11.33,4.29,16.9,4.29,1.62,0,3.14-.12,4.57-.33,6.8,4.34,15.14,6.65,24.39,6.65,5.79,0,10.1-.92,10.9-1.1h.05s.05-.03,.05-.03c1.79-.42,11.19-2.9,19.92-10.14,13-10.78,17.93-26.41,13.88-44-3.27-14.23-11.74-24.54-23.77-29.65,.33-1.2,.54-2.15,.67-2.77,.53-2.37,1.63-8.83,.11-16.75-1.64-8.58-6.67-20.67-21.27-29.52-6.8-4.12-13.98-6.21-21.35-6.21h0Z"/>
              </g>
            </g>
          </svg>
        </div>
        <p>
          Click to ascertain the cloud's existence.
        </p>
        <script>
          document.querySelector('#cloud1').addEventListener('click',()=>fetch('./is_exists'))
        </script>
        <nav>
          <p class="prev" onclick='pager(6)'>
            ←
          </p>
          <p class="next">
          </p>
        </nav>  
      </article>
    </main>
    <script>
      const pager =(page)=>{
        document.querySelector(`article.active`).classList.remove('active')
        document.querySelector(`article.page${String(page)}`).classList.add('active')
        window.scrollTo(0,0)
      }
    </script>
  </body>
</html>
)";

void loop(){
  WiFiClient client = server.available();
  if (client) {
    String currentLine = "";
    while (client.connected()) {
      if (client.available()) {
        char c = client.read();
        Serial.write(c);
        if (c == '\n') {
          if (currentLine.length() == 0) {
            client.println("HTTP/1.1 200 OK");
            client.println("Content-type:text/html");
            client.println();
            client.print(html);
            client.println();
            for(int i=0; i<7; i++){
              for(uint16_t count=0; count<30; count++){
                digitalWrite(spIn, HIGH);
                delayMicroseconds(460);
                digitalWrite(spIn, LOW);
                delayMicroseconds(460);
              }
              Serial.write(i);
              delay(50);
            }
            break;
            } else {
            currentLine = "";
          }
        } else if (c != '\r') {
          currentLine += c;
        }
        if (currentLine.startsWith("GET /?key=")) {
          // do nothing
          break;
        }else if (currentLine.endsWith("GET /is_exists")) {
          client.println("HTTP/1.1 200 OK");
          client.println("Content-type:text/plain");
          client.println();
          client.println(true);
          for(int i=0; i<7; i++){
            for(uint16_t count=0; count<30; count++){
              digitalWrite(spIn, HIGH);
              delayMicroseconds(460);
              digitalWrite(spIn, LOW);
              delayMicroseconds(460);
            }
            Serial.write(i);
            delay(50);
          }
          break;
        }
      }
    }
    client.stop();
  }
}

/*
 * reference: WiFi Web Server LED Blink https://github.com/espressif/arduino-esp32/blob/master/libraries/WiFi/examples/SimpleWiFiServer/SimpleWiFiServer.ino
 */
